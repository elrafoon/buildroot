## configs/rtu_defconfig
```kconfig
BR2_arm=y
BR2_JLEVEL=10
BR2_UCLIBC_CONFIG="board/rtu/uClibc-0.9.33.config"
BR2_TOOLCHAIN_BUILDROOT_LARGEFILE=y
BR2_TOOLCHAIN_BUILDROOT_INET_IPV6=y
BR2_TOOLCHAIN_BUILDROOT_LOCALE=y
BR2_PTHREAD_DEBUG=y
BR2_TOOLCHAIN_BUILDROOT_CXX=y
BR2_TARGET_GENERIC_HOSTNAME="rtu"
BR2_TARGET_GENERIC_ISSUE="Welcome to RTU"
BR2_ROOTFS_DEVICE_TABLE="board/rtu/device_table.txt"
BR2_TARGET_GENERIC_ROOT_PASSWD="gandalf"
BR2_TARGET_GENERIC_GETTY_PORT="ttyAMA0"
BR2_ROOTFS_OVERLAY="board/rtu/overlay"
BR2_ROOTFS_POST_BUILD_SCRIPT="board/rtu/scripts/add_runit_to_inittab board/rtu/scripts/setup_users"
BR2_LINUX_KERNEL=y
BR2_LINUX_KERNEL_CUSTOM_GIT=y
BR2_LINUX_KERNEL_CUSTOM_REPO_URL="ssh://merlin.swind.sk:29418/tx28/linux.git"
BR2_LINUX_KERNEL_CUSTOM_REPO_VERSION="master-dt"
BR2_LINUX_KERNEL_DEFCONFIG="mrc28b"
BR2_LINUX_KERNEL_UIMAGE_LOADADDR="0x40008000"
BR2_LINUX_KERNEL_DTS_SUPPORT=y
BR2_LINUX_KERNEL_INTREE_DTS_NAME="imx28-mrc28b"
BR2_LINUX_KERNEL_INSTALL_TARGET=y
BR2_PACKAGE_BUSYBOX_CONFIG="board/rtu/busybox-1.21.x.config"
BR2_PACKAGE_BUSYBOX_SHOW_OTHERS=y
BR2_PACKAGE_BUSYBOX_WATCHDOG=y
BR2_PACKAGE_PERF=y
BR2_PACKAGE_STRACE=y
BR2_PACKAGE_MTD=y
BR2_PACKAGE_PICOCOM=y
BR2_PACKAGE_OPENDAF=y
BR2_PACKAGE_OPENDAF_PLATFORM_RTU=y
BR2_PACKAGE_OPENDAF_STARTUP_RUNIT=y
BR2_PACKAGE_PYTHON=y
BR2_PACKAGE_PYTHON_PYOPENDAF=y
BR2_PACKAGE_PYTHON_MAKO=y
BR2_PACKAGE_PYTHON_CHERRYPY=y
BR2_PACKAGE_JPEG=y
BR2_PACKAGE_LIBPNG=y
BR2_PACKAGE_LIBUNGIF=y
BR2_PACKAGE_ACE=y
BR2_PACKAGE_BOOST=y
BR2_PACKAGE_BOOST_REGEX=y
BR2_PACKAGE_BOOST_SIGNALS=y
BR2_PACKAGE_BOOST_SYSTEM=y
BR2_PACKAGE_ELFUTILS=y
BR2_PACKAGE_DROPBEAR=y
BR2_PACKAGE_LINKS=y
BR2_PACKAGE_NETSNMP=y
BR2_PACKAGE_NTP=y
BR2_PACKAGE_NTP_NTPDATE=y
BR2_PACKAGE_FILE=y
BR2_PACKAGE_HTOP=y
BR2_PACKAGE_PROCPS=y
BR2_PACKAGE_UTIL_LINUX=y
BR2_PACKAGE_UTIL_LINUX_BINARIES=y
BR2_PACKAGE_UTIL_LINUX_CHFN_CHSH=y
BR2_PACKAGE_OPENBOX_WEBADMIN=y
BR2_PACKAGE_OPENBOX_WEBADMIN_STARTUP_RUNIT=y
BR2_TARGET_ROOTFS_UBIFS=y
BR2_TARGET_ROOTFS_UBIFS_LEBSIZE=0x1f000
BR2_TARGET_ROOTFS_UBIFS_MAXLEBCNT=830
BR2_TARGET_UBOOT=y
BR2_TARGET_UBOOT_BOARDNAME="mrc28b"
BR2_TARGET_UBOOT_CUSTOM_GIT=y
BR2_TARGET_UBOOT_CUSTOM_REPO_URL="ssh://merlin.swind.sk:29418/tx28/u-boot.git"
BR2_TARGET_UBOOT_CUSTOM_REPO_VERSION="master-dt"
BR2_TARGET_UBOOT_FORMAT_SB=y
```

## configs/suzipanel_defconfig
```kconfig
BR2_arm=y
BR2_arm920t=y
BR2_JLEVEL=10
BR2_KERNEL_HEADERS_VERSION=y
BR2_DEFAULT_KERNEL_VERSION="2.6.32"
BR2_UCLIBC_CONFIG="board/openbox/uClibc-0.9.33.config"
BR2_TOOLCHAIN_BUILDROOT_LARGEFILE=y
BR2_TOOLCHAIN_BUILDROOT_LOCALE=y
BR2_TOOLCHAIN_BUILDROOT_CXX=y
BR2_PTHREAD_DEBUG=y
BR2_TARGET_GENERIC_HOSTNAME="suzipanel"
BR2_TARGET_GENERIC_ISSUE="Welcome to SUZI panel"
BR2_ROOTFS_DEVICE_TABLE="board/openbox/device_table.txt"
BR2_TARGET_GENERIC_ROOT_PASSWD="gandalf"
BR2_TARGET_GENERIC_GETTY_PORT="ttyAMA0"
BR2_ROOTFS_OVERLAY="board/suzipanel/overlay"
BR2_ROOTFS_POST_BUILD_SCRIPT="board/suzipanel/scripts/add_runit_to_inittab board/suzipanel/scripts/setup_users"
BR2_PACKAGE_BUSYBOX_CONFIG="board/openbox/busybox-1.21.x.config"
BR2_PACKAGE_BUSYBOX_WATCHDOG=y
BR2_PACKAGE_PERF=y
BR2_PACKAGE_FBV=y
BR2_PACKAGE_QT=y
BR2_PACKAGE_QT_LICENSE_APPROVED=y
BR2_PACKAGE_QT_QTFREETYPE=y
BR2_PACKAGE_QT_GIF=y
BR2_PACKAGE_QT_LIBMNG=y
BR2_PACKAGE_QT_QTJPEG=y
BR2_PACKAGE_QT_SYSTEMPNG=y
BR2_PACKAGE_QT_SYSTEMTIFF=y
BR2_PACKAGE_QT_MOUSE_TSLIB=y
BR2_PACKAGE_QT_SVG=y
BR2_PACKAGE_QT_WEBKIT=y
BR2_PACKAGE_QT_JAVASCRIPTCORE=y
BR2_PACKAGE_QT_STL=y
BR2_PACKAGE_QT_SCRIPTTOOLS=y
BR2_PACKAGE_MTD=y
BR2_PACKAGE_PICOCOM=y
BR2_PACKAGE_OPENDAF=y
BR2_PACKAGE_OPENDAF_STARTUP_RUNIT=y
BR2_PACKAGE_UHMI=y
BR2_PACKAGE_UHMI_SCAN_PERIOD=1000
BR2_PACKAGE_UHMI_DEMOS=y
BR2_PACKAGE_UHMI_DEMOS_DEMO="exh"
BR2_PACKAGE_UHMI_DEMOS_INDEX="pages/lan-8io.html"
BR2_PACKAGE_WAVEGEN=y
BR2_PACKAGE_PYTHON=y
BR2_PACKAGE_PYTHON_MAKO=y
BR2_PACKAGE_PYTHON_CHERRYPY=y
BR2_PACKAGE_TSLIB=y
BR2_PACKAGE_ACE=y
BR2_PACKAGE_ELFUTILS=y
BR2_PACKAGE_BOOST=y
BR2_PACKAGE_BOOST_REGEX=y
BR2_PACKAGE_BOOST_SIGNALS=y
BR2_PACKAGE_BOOST_SYSTEM=y
BR2_PACKAGE_DROPBEAR=y
BR2_PACKAGE_LINKS=y
BR2_PACKAGE_NETSNMP=y
BR2_PACKAGE_NTP=y
BR2_PACKAGE_NTP_NTPDATE=y
BR2_PACKAGE_RQWB=y
BR2_PACKAGE_RQWB_STARTUP_RUNIT=y
BR2_PACKAGE_HTOP=y
BR2_PACKAGE_UTIL_LINUX=y
BR2_PACKAGE_UTIL_LINUX_BINARIES=y
BR2_PACKAGE_UTIL_LINUX_CHFN_CHSH=y
BR2_PACKAGE_OPENBOX_WEBADMIN=y
BR2_PACKAGE_OPENBOX_WEBADMIN_STARTUP_RUNIT=y
BR2_TARGET_ROOTFS_EXT2=y
BR2_TARGET_ROOTFS_EXT2_3=y
BR2_LINUX_KERNEL=y
BR2_LINUX_KERNEL_CUSTOM_GIT=y
BR2_LINUX_KERNEL_CUSTOM_GIT_REPO_URL="ssh://merlin.swind.sk:29418/suzi/suzipanel/linux.git"
BR2_LINUX_KERNEL_DEFCONFIG="suzipanel"
```

## configs/tind_bios_falcon_defconfig
```kconfig
BR2_arm=y
BR2_MACHINE="falcon"
BR2_JLEVEL=10
BR2_TOOLCHAIN_EXTERNAL=y
BR2_TOOLCHAIN_EXTERNAL_CUSTOM=y
BR2_TOOLCHAIN_EXTERNAL_PATH="/home/stano/buildroot/toolchain/arm-swindustry-linux-uclibcgnueabi"
BR2_TOOLCHAIN_EXTERNAL_CUSTOM_PREFIX="$(ARCH)-swindustry-linux-uclibcgnueabi"
BR2_TOOLCHAIN_EXTERNAL_HEADERS_3_14=y
BR2_TOOLCHAIN_EXTERNAL_LARGEFILE=y
BR2_TOOLCHAIN_EXTERNAL_WCHAR=y
# BR2_TOOLCHAIN_EXTERNAL_HAS_THREADS_DEBUG is not set
BR2_TARGET_GENERIC_HOSTNAME="bios"
BR2_TARGET_GENERIC_ISSUE="Welcome to BIOS"
BR2_TARGET_GENERIC_ROOT_PASSWD="gandalf"
BR2_TARGET_GENERIC_GETTY_PORT="ttyAMA0"
# BR2_TARGET_GENERIC_REMOUNT_ROOTFS_RW is not set
BR2_LINUX_KERNEL=y
BR2_LINUX_KERNEL_CUSTOM_GIT=y
BR2_LINUX_KERNEL_CUSTOM_REPO_URL="gitolite@merlin.swind.sk:tx28/linux"
BR2_LINUX_KERNEL_CUSTOM_REPO_VERSION="master-dt"
BR2_LINUX_KERNEL_DEFCONFIG="tx28_headless_lowmem"
BR2_LINUX_KERNEL_UIMAGE_LOADADDR="0x40008000"
BR2_LINUX_KERNEL_DTS_SUPPORT=y
BR2_LINUX_KERNEL_INTREE_DTS_NAME="imx28-falcon"
BR2_PACKAGE_BUSYBOX_CONFIG="package/mod/mod-bios/busybox-1.21.x.config"
BR2_PACKAGE_BUSYBOX_WATCHDOG=y
BR2_PACKAGE_MOD_BIOS=y
BR2_PACKAGE_SYSTEMTEST=y
BR2_PACKAGE_E2FSPROGS=y
BR2_PACKAGE_E2FSPROGS_RESIZE2FS=y
BR2_PACKAGE_PPPD=y
BR2_PACKAGE_FILE=y
BR2_PACKAGE_GNUPG=y
BR2_PACKAGE_GNUPG_RSA=y
BR2_PACKAGE_UTIL_LINUX_BINARIES=y
BR2_TARGET_ROOTFS_CPIO_XZ=y
BR2_TARGET_ROOTFS_CPIO_UIMAGE=y
BR2_TARGET_ROOTFS_INITRAMFS=y
BR2_TARGET_UBOOT=y
BR2_TARGET_UBOOT_BOARDNAME="tx28-41x0"
BR2_TARGET_UBOOT_CUSTOM_GIT=y
BR2_TARGET_UBOOT_CUSTOM_REPO_URL="gitolite@merlin.swind.sk:tx28/u-boot.git"
BR2_TARGET_UBOOT_CUSTOM_REPO_VERSION="master-dt"
BR2_TARGET_UBOOT_CUSTOM_PATCH_DIR="board/tind/falcon/patch"
BR2_TARGET_UBOOT_FORMAT_SB=y
```

## configs/tind_compactio-zlatastudna_defconfig
```kconfig
BR2_arm=y
BR2_JLEVEL=10
BR2_KERNEL_HEADERS_3_2=y
BR2_TOOLCHAIN_BUILDROOT_EGLIBC=y
BR2_TOOLCHAIN_BUILDROOT_CXX=y
BR2_PACKAGE_HOST_GDB=y
BR2_TARGET_GENERIC_HOSTNAME="compactio"
BR2_TARGET_GENERIC_ISSUE="Welcome to CompactIO"
BR2_ROOTFS_DEVICE_TABLE="board/tind/compact-rtu/device_table.txt"
BR2_TARGET_GENERIC_ROOT_PASSWD="gandalf"
BR2_TARGET_GENERIC_GETTY_PORT="ttyAMA0"
BR2_ROOTFS_OVERLAY="board/tind/compact-rtu/overlay"
BR2_ROOTFS_POST_BUILD_SCRIPT="board/tind/compact-rtu/scripts/add_runit_to_inittab board/tind/compact-rtu/scripts/setup_users board/tind/compact-rtu/scripts/pb_mod_zlatastudna"
BR2_ROOTFS_POST_IMAGE_SCRIPT="board/tind/compact-rtu/scripts/pi_mkvar board/tind/compact-rtu/scripts/pi_sign_rootfs"
BR2_LINUX_KERNEL=y
BR2_LINUX_KERNEL_CUSTOM_GIT=y
BR2_LINUX_KERNEL_CUSTOM_REPO_URL="gitolite@merlin.swind.sk:tx28/linux"
BR2_LINUX_KERNEL_CUSTOM_REPO_VERSION="master"
BR2_LINUX_KERNEL_DEFCONFIG="compactio"
BR2_PACKAGE_BUSYBOX_CONFIG="board/compact-rtu/busybox-1.21.x.config"
BR2_PACKAGE_BUSYBOX_WATCHDOG=y
BR2_PACKAGE_GDB=y
BR2_PACKAGE_LTRACE=y
BR2_PACKAGE_STRACE=y
BR2_PACKAGE_MTD=y
BR2_PACKAGE_PICOCOM=y
BR2_PACKAGE_REMSERIAL=y
BR2_PACKAGE_OPENDAF=y
BR2_PACKAGE_OPENDAF_PLATFORM_OPENBOX=y
BR2_PACKAGE_OPENDAF_STARTUP_RUNIT=y
BR2_PACKAGE_OPENDAF_APPCONF=y
BR2_PACKAGE_OPENDAF_APPCONF_NAME="compactio-zlatastudna"
BR2_PACKAGE_GNUTLS=y
BR2_PACKAGE_SQLITE=y
BR2_PACKAGE_LIBPNG=y
BR2_PACKAGE_LIBUNGIF=y
BR2_PACKAGE_TIFF=y
BR2_PACKAGE_TSLIB=y
BR2_PACKAGE_ACE=y
BR2_PACKAGE_ARGP_STANDALONE=y
BR2_PACKAGE_BOOST=y
BR2_PACKAGE_BOOST_REGEX=y
BR2_PACKAGE_BOOST_SIGNALS=y
BR2_PACKAGE_BOOST_SYSTEM=y
BR2_PACKAGE_ELFUTILS=y
BR2_PACKAGE_LIBFFI=y
BR2_PACKAGE_PROTOBUF=y
BR2_PACKAGE_TZDATA=y
BR2_PACKAGE_TZDATA_ZONELIST="europe"
BR2_PACKAGE_DROPBEAR=y
BR2_PACKAGE_HEIRLOOM_MAILX=y
BR2_PACKAGE_LIGHTTPD=y
BR2_PACKAGE_LIGHTTPD_OPENSSL=y
BR2_PACKAGE_LIGHTTPD_PCRE=y
BR2_PACKAGE_LINKS=y
BR2_PACKAGE_NETSNMP=y
BR2_PACKAGE_NTP=y
BR2_PACKAGE_NTP_NTPDATE=y
BR2_PACKAGE_NTP_NTPQ=y
BR2_PACKAGE_NULLMAILER=y
BR2_PACKAGE_OPENVPN=y
BR2_PACKAGE_VSFTPD=y
BR2_PACKAGE_SIMPLEMAIL=y
BR2_PACKAGE_FWUPDATE=y
BR2_PACKAGE_FWUPDATE_INSTALL_MARKREADY_INITSCRIPT=y
BR2_PACKAGE_HTOP=y
BR2_PACKAGE_UTIL_LINUX=y
BR2_PACKAGE_UTIL_LINUX_BINARIES=y
BR2_PACKAGE_UTIL_LINUX_CHFN_CHSH=y
BR2_PACKAGE_OPENBOX_TEMPLATES=y
BR2_TARGET_ROOTFS_UBIFS=y
BR2_TARGET_ROOTFS_UBIFS_LEBSIZE=0x1f000
BR2_TARGET_ROOTFS_UBIFS_MAXLEBCNT=830
BR2_TARGET_UBOOT=y
BR2_TARGET_UBOOT_BOARDNAME="compactio"
BR2_TARGET_UBOOT_CUSTOM_GIT=y
BR2_TARGET_UBOOT_CUSTOM_REPO_URL="gitolite@merlin.swind.sk:tx28/u-boot"
BR2_TARGET_UBOOT_CUSTOM_REPO_VERSION="master"
BR2_TARGET_UBOOT_FORMAT_SB=y
```

## configs/tind_compactrtu-falcon_defconfig
```kconfig
BR2_arm=y
BR2_LUAROCKS_MIRROR="http://luarocks.org"
BR2_JLEVEL=10
BR2_TOOLCHAIN_EXTERNAL=y
BR2_TOOLCHAIN_EXTERNAL_CUSTOM=y
BR2_TOOLCHAIN_EXTERNAL_PATH="/home/stano/buildroot/toolchain/arm-v5te-linux-gnueabi"
BR2_TOOLCHAIN_EXTERNAL_CUSTOM_PREFIX="arm-v5te-linux-gnueabi"
BR2_TOOLCHAIN_EXTERNAL_HEADERS_3_14=y
BR2_TOOLCHAIN_EXTERNAL_CUSTOM_GLIBC=y
# BR2_TOOLCHAIN_EXTERNAL_INET_RPC is not set
BR2_TOOLCHAIN_EXTERNAL_CXX=y
BR2_TOOLCHAIN_EXTERNAL_GDB_SERVER_COPY=y
BR2_ENABLE_LOCALE_PURGE=y
BR2_ENABLE_LOCALE_WHITELIST="C en_US de fr sk cs"
BR2_TARGET_GENERIC_HOSTNAME="falcon"
BR2_TARGET_GENERIC_ISSUE="Welcome to FALCON"
BR2_INIT_SYSTEMD=y
BR2_ROOTFS_DEVICE_TABLE="board/tind/compact-rtu/device_table.txt"
BR2_TARGET_GENERIC_ROOT_PASSWD="gandalf"
BR2_TARGET_GENERIC_GETTY_PORT="ttyAMA0"
BR2_TARGET_TZ_INFO=y
BR2_TARGET_TZ_ZONELIST="europe"
BR2_TARGET_LOCALTIME="Europe/Bratislava"
BR2_ROOTFS_USERS_TABLES="board/tind/compact-rtu/user_table.txt"
BR2_ROOTFS_OVERLAY="board/tind/compact-rtu/overlay"
BR2_ROOTFS_POST_BUILD_SCRIPT="board/tind/compact-rtu/scripts/pb_mod_falcon board/tind/compact-rtu/scripts/pb_var_etc board/tind/compact-rtu/scripts/pb_fixup support/scripts/pb_release"
BR2_ROOTFS_POST_IMAGE_SCRIPT="board/tind/compact-rtu/scripts/pi_mkvar support/scripts/pi_release"
BR2_LINUX_KERNEL=y
BR2_LINUX_KERNEL_CUSTOM_GIT=y
BR2_LINUX_KERNEL_CUSTOM_REPO_URL="gitolite@merlin.swind.sk:tx28/linux"
BR2_LINUX_KERNEL_CUSTOM_REPO_VERSION="master-dt"
BR2_LINUX_KERNEL_DEFCONFIG="tx28_headless_lowmem"
BR2_LINUX_KERNEL_UIMAGE_LOADADDR="0x40008000"
BR2_LINUX_KERNEL_DTS_SUPPORT=y
BR2_LINUX_KERNEL_INTREE_DTS_NAME="imx28-dave"
BR2_PACKAGE_BUSYBOX_CONFIG="board/tind/compact-rtu/busybox-1.22.x.config"
BR2_PACKAGE_BUSYBOX_WATCHDOG=y
BR2_PACKAGE_LTRACE=y
BR2_PACKAGE_STRACE=y
BR2_PACKAGE_E2FSPROGS=y
# BR2_PACKAGE_E2FSPROGS_BADBLOCKS is not set
# BR2_PACKAGE_E2FSPROGS_DUMPE2FS is not set
# BR2_PACKAGE_E2FSPROGS_E2FREEFRAG is not set
# BR2_PACKAGE_E2FSPROGS_FILEFRAG is not set
BR2_PACKAGE_E2FSPROGS_RESIZE2FS=y
BR2_PACKAGE_MTD=y
BR2_PACKAGE_DEVMEM2=y
BR2_PACKAGE_JSON_DBUS_BRIDGE=y
BR2_PACKAGE_PICOCOM=y
BR2_PACKAGE_REMSERIAL=y
BR2_PACKAGE_OPENDAF=y
BR2_PACKAGE_OPENDAF_PLATFORM_OPENBOX=y
BR2_PACKAGE_OPENDAF_DAFMAN=y
BR2_PACKAGE_OPENDAF_DAFMAND=y
BR2_PACKAGE_OPENDAF_APPCONF=y
BR2_PACKAGE_OPENDAF_APPCONF_NAME="falcon"
BR2_PACKAGE_RTUADMIN_VERSION="systemd"
BR2_PACKAGE_RTUADMIN_SERVER=y
BR2_PACKAGE_RTUADMIN_CLIENT=y
BR2_PACKAGE_RTUADMIN_TEMPLATES=y
BR2_PACKAGE_LUA=y
BR2_PACKAGE_COSMO=y
BR2_PACKAGE_SQLITE=y
BR2_PACKAGE_SOCI=y
BR2_PACKAGE_LIBPNG=y
BR2_PACKAGE_LIBUNGIF=y
BR2_PACKAGE_TIFF=y
BR2_PACKAGE_TSLIB=y
BR2_PACKAGE_CJSON=y
BR2_PACKAGE_LIBCURL=y
BR2_PACKAGE_CURL=y
BR2_PACKAGE_LIBFCGI=y
BR2_PACKAGE_ACE=y
BR2_PACKAGE_ARGP_STANDALONE=y
BR2_PACKAGE_BOOST=y
BR2_PACKAGE_BOOST_DATE_TIME=y
BR2_PACKAGE_BOOST_REGEX=y
BR2_PACKAGE_BOOST_SIGNALS=y
BR2_PACKAGE_BOOST_SYSTEM=y
BR2_PACKAGE_GLIBMM=y
BR2_PACKAGE_PROTOBUF=y
BR2_PACKAGE_HEIRLOOM_MAILX=y
BR2_PACKAGE_CRONTAB_CGI=y
BR2_PACKAGE_DHCPCD=y
BR2_PACKAGE_DROPBEAR=y
BR2_PACKAGE_LIGHTTPD=y
BR2_PACKAGE_LIGHTTPD_OPENSSL=y
BR2_PACKAGE_LIGHTTPD_PCRE=y
BR2_PACKAGE_LIGHTTPD_PAM=y
BR2_PACKAGE_LINKS=y
BR2_PACKAGE_NETSNMP=y
BR2_PACKAGE_NETWORK_MANAGER=y
BR2_PACKAGE_NETWORK_MANAGER_TUI=y
BR2_PACKAGE_NETWORK_MANAGER_MODEM_MANAGER=y
BR2_PACKAGE_NETWORK_MANAGER_PPPD=y
BR2_PACKAGE_NTP=y
BR2_PACKAGE_NTP_NTPDATE=y
BR2_PACKAGE_NTP_NTPQ=y
BR2_PACKAGE_NULLMAILER=y
BR2_PACKAGE_OPENVPN=y
BR2_PACKAGE_VSFTPD=y
BR2_PACKAGE_FILE=y
BR2_PACKAGE_SIMPLEMAIL=y
BR2_PACKAGE_DCRON=y
BR2_PACKAGE_FWUPDATE=y
BR2_PACKAGE_FWUPDATE_INSTALL_MARKREADY_INITSCRIPT=y
BR2_PACKAGE_HTOP=y
BR2_PACKAGE_SYSTEMD_JOURNAL_GATEWAY=y
BR2_PACKAGE_SYSTEMD_NETWORKD=y
BR2_PACKAGE_UTIL_LINUX_BINARIES=y
BR2_PACKAGE_UTIL_LINUX_CHFN_CHSH=y
BR2_PACKAGE_UTIL_LINUX_FSCK=y
BR2_PACKAGE_OPENBOX_TEMPLATES=y
BR2_TARGET_ROOTFS_EXT2=y
BR2_TARGET_ROOTFS_EXT2_4=y
BR2_TARGET_ROOTFS_UBIFS=y
BR2_TARGET_ROOTFS_UBIFS_LEBSIZE=0x1f000
BR2_TARGET_ROOTFS_UBIFS_MAXLEBCNT=830
BR2_TARGET_ROOTFS_UBIFS_RT_ZLIB=y
BR2_TARGET_UBOOT=y
BR2_TARGET_UBOOT_BOARDNAME="tx28-41x0"
BR2_TARGET_UBOOT_CUSTOM_GIT=y
BR2_TARGET_UBOOT_CUSTOM_REPO_URL="gitolite@merlin.swind.sk:tx28/u-boot.git"
BR2_TARGET_UBOOT_CUSTOM_REPO_VERSION="master-dt"
BR2_TARGET_UBOOT_FORMAT_SB=y
```

## configs/tind_compactrtu-recovery_defconfig
```kconfig
BR2_arm=y
BR2_JLEVEL=10
BR2_TOOLCHAIN_BUILDROOT_VENDOR="swindustry"
BR2_KERNEL_HEADERS_3_14=y
BR2_TARGET_GENERIC_HOSTNAME="recovery"
BR2_TARGET_GENERIC_ISSUE="Welcome to system recovery"
BR2_TARGET_GENERIC_ROOT_PASSWD="gandalf"
BR2_TARGET_GENERIC_GETTY_PORT="ttyAMA0"
# BR2_TARGET_GENERIC_REMOUNT_ROOTFS_RW is not set
BR2_ROOTFS_OVERLAY="board/tind/compact-rtu/overlay-recovery"
BR2_LINUX_KERNEL=y
BR2_LINUX_KERNEL_CUSTOM_GIT=y
BR2_LINUX_KERNEL_CUSTOM_REPO_URL="gitolite@merlin.swind.sk:tx28/linux"
BR2_LINUX_KERNEL_CUSTOM_REPO_VERSION="master-dt"
BR2_LINUX_KERNEL_DEFCONFIG="tx28_headless_lowmem"
BR2_LINUX_KERNEL_UIMAGE_LOADADDR="0x40008000"
BR2_LINUX_KERNEL_DTS_SUPPORT=y
BR2_LINUX_KERNEL_INTREE_DTS_NAME="imx28-dave"
BR2_PACKAGE_BUSYBOX_CONFIG="board/tind/compact-rtu/busybox-1.21.x-recovery.config"
BR2_PACKAGE_BUSYBOX_WATCHDOG=y
BR2_PACKAGE_MTD=y
BR2_PACKAGE_DROPBEAR=y
BR2_PACKAGE_VSFTPD=y
BR2_PACKAGE_GNUPG=y
BR2_PACKAGE_GNUPG_RSA=y
BR2_PACKAGE_FWUPDATE=y
BR2_TARGET_ROOTFS_CPIO_XZ=y
BR2_TARGET_ROOTFS_CPIO_UIMAGE=y
BR2_TARGET_ROOTFS_INITRAMFS=y
```

## configs/tind_lightpanel-recovery_defconfig
```kconfig
BR2_arm=y
BR2_JLEVEL=10
BR2_KERNEL_HEADERS_3_2=y
BR2_TARGET_GENERIC_HOSTNAME="lightpanel"
BR2_TARGET_GENERIC_ISSUE="Welcome to LIGHTpanel recovery"
BR2_TARGET_GENERIC_ROOT_PASSWD="gandalf"
BR2_TARGET_GENERIC_GETTY_PORT="ttyAMA0"
# BR2_TARGET_GENERIC_REMOUNT_ROOTFS_RW is not set
BR2_ROOTFS_OVERLAY="board/tind/lightpanel/overlay-recovery"
BR2_LINUX_KERNEL=y
BR2_LINUX_KERNEL_CUSTOM_GIT=y
BR2_LINUX_KERNEL_CUSTOM_REPO_URL="gitolite@merlin.swind.sk:tx28/linux"
BR2_LINUX_KERNEL_CUSTOM_REPO_VERSION="master"
BR2_LINUX_KERNEL_DEFCONFIG="ftt_tx_cap"
BR2_PACKAGE_BUSYBOX_CONFIG="board/tind/lightpanel/busybox-1.21.x-recovery.config"
BR2_PACKAGE_BUSYBOX_WATCHDOG=y
BR2_PACKAGE_XZ=y
BR2_PACKAGE_MTD=y
BR2_PACKAGE_FBV=y
BR2_PACKAGE_DROPBEAR=y
BR2_PACKAGE_VSFTPD=y
BR2_PACKAGE_GNUPG=y
BR2_PACKAGE_GNUPG_RSA=y
BR2_PACKAGE_FWUPDATE=y
BR2_TARGET_ROOTFS_CPIO_XZ=y
BR2_TARGET_ROOTFS_CPIO_UIMAGE=y
BR2_TARGET_ROOTFS_INITRAMFS=y
BR2_TARGET_UBOOT=y
BR2_TARGET_UBOOT_BOARDNAME="ftt_tx"
BR2_TARGET_UBOOT_CUSTOM_GIT=y
BR2_TARGET_UBOOT_CUSTOM_REPO_URL="gitolite@merlin.swind.sk:tx28/u-boot"
BR2_TARGET_UBOOT_CUSTOM_REPO_VERSION="master"
BR2_TARGET_UBOOT_FORMAT_SB=y
```
