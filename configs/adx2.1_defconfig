## configs/tind_lightpanel_defconfig
```kconfig
BR2_arm=y
BR2_JLEVEL=10
BR2_KERNEL_HEADERS_3_2=y
BR2_TOOLCHAIN_BUILDROOT_GLIBC=y
BR2_TOOLCHAIN_BUILDROOT_CXX=y
BR2_PACKAGE_HOST_GDB=y
BR2_GDB_VERSION_7_4=y
BR2_TARGET_GENERIC_HOSTNAME="lightpanel"
BR2_TARGET_GENERIC_ISSUE="Welcome to LIGHTpanel"
BR2_ROOTFS_DEVICE_TABLE="board/tind/lightpanel/device_table.txt"
BR2_TARGET_GENERIC_ROOT_PASSWD="gandalf"
BR2_TARGET_GENERIC_GETTY_PORT="ttyAMA0"
BR2_ROOTFS_OVERLAY="board/tind/lightpanel/overlay"
BR2_ROOTFS_POST_BUILD_SCRIPT="board/tind/lightpanel/scripts/pb_add_runit_to_inittab board/tind/lightpanel/scripts/pb_setup_users support/scripts/pb_release"
BR2_ROOTFS_POST_IMAGE_SCRIPT="board/tind/lightpanel/scripts/pi_mkvar board/tind/lightpanel/scripts/pi_sign_rootfs support/scripts/pi_release"
BR2_LINUX_KERNEL=y
BR2_LINUX_KERNEL_CUSTOM_GIT=y
BR2_LINUX_KERNEL_CUSTOM_REPO_URL="gitolite@merlin.swind.sk:tx28/linux"
BR2_LINUX_KERNEL_CUSTOM_REPO_VERSION="master"
BR2_LINUX_KERNEL_DEFCONFIG="ftt_tx_cap"
BR2_PACKAGE_BUSYBOX_CONFIG="board/tind/lightpanel/busybox-1.21.x.config"
BR2_PACKAGE_BUSYBOX_WATCHDOG=y
BR2_PACKAGE_GDB=y
BR2_PACKAGE_STRACE=y
BR2_PACKAGE_MTD=y
BR2_PACKAGE_QT=y
BR2_PACKAGE_QT_LICENSE_APPROVED=y
BR2_PACKAGE_QT_QTFREETYPE=y
BR2_PACKAGE_QT_GIF=y
BR2_PACKAGE_QT_LIBMNG=y
BR2_PACKAGE_QT_QTJPEG=y
BR2_PACKAGE_QT_SYSTEMPNG=y
BR2_PACKAGE_QT_SYSTEMTIFF=y
BR2_PACKAGE_QT_SQL_MODULE=y
BR2_PACKAGE_QT_SQLITE_QT=y
BR2_PACKAGE_QT_MOUSE_TSLIB=y
BR2_PACKAGE_QT_MOUSE_NO_QWS_CURSOR=y
BR2_PACKAGE_QT_SVG=y
BR2_PACKAGE_QT_WEBKIT=y
BR2_PACKAGE_QT_STL=y
BR2_PACKAGE_QT_SCRIPTTOOLS=y
BR2_PACKAGE_QT_DECLARATIVE=y
BR2_PACKAGE_PICOCOM=y
BR2_PACKAGE_REMSERIAL=y
BR2_PACKAGE_RTUADMIN_VERSION="lightpanel"
BR2_PACKAGE_RTUADMIN_SERVER=y
BR2_PACKAGE_RTUADMIN_CLIENT=y
BR2_PACKAGE_RTUADMIN_TEMPLATES=y
BR2_PACKAGE_LUA=y
BR2_PACKAGE_LUACOSMO=y
BR2_PACKAGE_LUALPEG=y
BR2_PACKAGE_PYTHON=y
BR2_PACKAGE_PYTHON_MAKO=y
BR2_PACKAGE_TSLIB=y
BR2_PACKAGE_CJSON=y
BR2_PACKAGE_ACE=y
BR2_PACKAGE_ARGP_STANDALONE=y
BR2_PACKAGE_BOOST=y
BR2_PACKAGE_BOOST_REGEX=y
BR2_PACKAGE_BOOST_SIGNALS=y
BR2_PACKAGE_BOOST_SYSTEM=y
BR2_PACKAGE_ELFUTILS=y
BR2_PACKAGE_LINUX_PAM=y
BR2_PACKAGE_PROTOBUF=y
BR2_PACKAGE_TZDATA=y
BR2_PACKAGE_TZDATA_ZONELIST="europe"
BR2_PACKAGE_DROPBEAR=y
BR2_PACKAGE_LIGHTTPD=y
BR2_PACKAGE_LIGHTTPD_PAM=y
BR2_PACKAGE_LINKS=y
BR2_PACKAGE_NTP=y
BR2_PACKAGE_NTP_NTPDATE=y
BR2_PACKAGE_NTP_NTPQ=y
BR2_PACKAGE_VSFTPD=y
BR2_PACKAGE_FWUPDATE=y
BR2_PACKAGE_FWUPDATE_INSTALL_MARKREADY_INITSCRIPT=y
BR2_PACKAGE_HTOP=y
BR2_PACKAGE_UTIL_LINUX=y
BR2_PACKAGE_DLS2_VERSION="light-lumen"
BR2_PACKAGE_DLS2_DCS=y
BR2_PACKAGE_DLS2_DCS_TARGET_PLATFORM_FTT_TX_2_2=y
BR2_PACKAGE_DLS2_DCSCONFIG=y
BR2_PACKAGE_DLS2_GUI=y
BR2_PACKAGE_OPENBOX_TEMPLATES=y
BR2_TARGET_ROOTFS_UBIFS=y
BR2_TARGET_ROOTFS_UBIFS_LEBSIZE=0x1f000
BR2_TARGET_ROOTFS_UBIFS_MAXLEBCNT=830
BR2_TARGET_ROOTFS_UBIFS_RT_ZLIB=y
BR2_TARGET_UBOOT=y
BR2_TARGET_UBOOT_BOARDNAME="ftt_tx"
BR2_TARGET_UBOOT_CUSTOM_GIT=y
BR2_TARGET_UBOOT_CUSTOM_REPO_URL="gitolite@merlin.swind.sk:tx28/u-boot"
BR2_TARGET_UBOOT_CUSTOM_REPO_VERSION="master"
BR2_TARGET_UBOOT_FORMAT_SB=y
```

## package/ACE/Config.in
```kconfig
config BR2_PACKAGE_ACE
	bool "ACE"
	help
	  This package contains Adaptive Commnication Environment.

	  http://www.dre.vanderbilt.edu/~schmidt/ACE.html
	
	depends on (BR2_INSTALL_LIBSTDCPP && (BR2_TOOLCHAIN_USES_GLIBC || (BR2_TOOLCHAIN_BUILDROOT_LARGEFILE && BR2_TOOLCHAIN_BUILDROOT_WCHAR)))

if BR2_PACKAGE_ACE

config BR2_PACKAGE_ACE_ETCL
	bool "ETCL"
	depends on BR2_PACKAGE_ACE
	default n

config BR2_PACKAGE_ACE_HTBP
	bool "HTBP"
	depends on BR2_PACKAGE_ACE
	default n

config BR2_PACKAGE_ACE_INET
	bool "INet"
	depends on BR2_PACKAGE_ACE
	default n

config BR2_PACKAGE_ACE_INET_SSL
	bool "INet_SSL"
	default n
	depends on BR2_PACKAGE_ACE
	depends on BR2_PACKAGE_ACE_SSL
	comment "INet_SSL depends on SSL"
		depends on !BR2_PACKAGE_ACE_SSL

config BR2_PACKAGE_ACE_MONITOR_CONTROL
	bool "Monitor_Control"
	depends on BR2_PACKAGE_ACE
	default n

config BR2_PACKAGE_ACE_RMCAST
	bool "RMCast"
	depends on BR2_PACKAGE_ACE
	default n

config BR2_PACKAGE_ACE_SSL
	bool "SSL"
	default n
	depends on BR2_PACKAGE_ACE
	depends on BR2_PACKAGE_OPENSSL
	comment "SSL depends on OpenSSL"	
		depends on !BR2_PACKAGE_OPENSSL

config BR2_PACKAGE_ACE_TMCAST
	bool "TMCast"
	depends on BR2_PACKAGE_ACE
	default n

config BR2_PACKAGE_ACE_XML
	bool "XML"
	depends on BR2_PACKAGE_ACE
	default n

endif

comment "ACE requires toolchain with C++, largefile and wchar support"
	depends on !(BR2_INSTALL_LIBSTDCPP && (BR2_TOOLCHAIN_USES_GLIBC || (BR2_TOOLCHAIN_BUILDROOT_LARGEFILE && BR2_TOOLCHAIN_BUILDROOT_WCHAR)))
```

## package/DLS-2/Config.in
```kconfig
menu "DLS-2"
config BR2_PACKAGE_DLS2_VERSION
	string "Product version"
	default "master"
	help
	  DLS-2 product version to use. It can be:
	  - git hash
	  - git branch
	  - git tag


source "package/DLS-2/dls2_hwtest/Config.in"
source "package/DLS-2/dls2_dcs/Config.in"
source "package/DLS-2/dls2_dcsconfig/Config.in"
source "package/DLS-2/dls2_gui/Config.in"
source "package/DLS-2/dls2_web/Config.in"
endmenu
```

## package/DLS-2/dls2_dcs/Config.in
```kconfig
config BR2_PACKAGE_DLS2_DCS
	bool "dls2_dcs"
	select BR2_PACKAGE_SQLITE
	select BR2_PACKAGE_SWIG
	depends on BR2_PACKAGE_ACE && BR2_PACKAGE_BOOST_SYSTEM && BR2_PACKAGE_PYTHON && BR2_PACKAGE_PYTHON_MAKO && BR2_PACKAGE_DLS2_DCSCONFIG
	help
		This package contains DLS2 DCS. 

if BR2_PACKAGE_DLS2_DCS

config BR2_PACKAGE_DLS2_DCS_BUILD_DCSLINK
	bool "Build dcslink protocol suite"
	default y
	depends on BR2_PACKAGE_DLS2_DCS && BR2_PACKAGE_SURPC && BR2_PACKAGE_PROTOBUF

comment "dcslink depends on SuRPC and protobuf"
	depends on BR2_PACKAGE_DLS2_DCS && !(BR2_PACKAGE_SURPC && BR2_PACKAGE_PROTOBUF)

config BR2_PACKAGE_DLS2_DCS_FW_UPDATE
	bool "Update embedded controller firmware during boot"
	default y
	depends on BR2_PACKAGE_DLS2_DCS

choice
	prompt "Target platform"
	default BR2_PACKAGE_DLS2_DCS_TARGET_PLATFORM_TX48
	depends on BR2_PACKAGE_DLS2_DCS

	config BR2_PACKAGE_DLS2_DCS_TARGET_PLATFORM_DESKTOP
		bool "DESKTOP"

	config BR2_PACKAGE_DLS2_DCS_TARGET_PLATFORM_TX48
		bool "TX48"

	config BR2_PACKAGE_DLS2_DCS_TARGET_PLATFORM_FTT_TX
		bool "FTT_TX"
		help
			"FTT_TX board <2.2"
	
	config BR2_PACKAGE_DLS2_DCS_TARGET_PLATFORM_FTT_TX_2_2
		bool "FTT_TX_2_2"
		help
			"FTT_TX board rev >=2.2"

endchoice

endif
	
comment "dcs depends on ACE, boost-system, python-mako and dls2_dcsconfig"
	depends on !(BR2_PACKAGE_ACE && BR2_PACKAGE_BOOST_SYSTEM && BR2_PACKAGE_PYTHON && BR2_PACKAGE_PYTHON_MAKO && BR2_PACKAGE_DLS2_DCSCONFIG)
```

## package/DLS-2/dls2_dcsconfig/Config.in
```kconfig
config BR2_PACKAGE_DLS2_DCSCONFIG
	bool "dls2_dcsconfig"
	select BR2_PACKAGE_PYTHON_SETUPTOOLS
	select BR2_PACKAGE_PYTHON_ZLIB
	select BR2_PACKAGE_PYTHON_MARKUPSAFE
	help
	  Download, build, install, upgrade, and uninstall Python packages.

	  http://www.makotemplates.org/downloads

	depends on BR2_PACKAGE_PYTHON

	comment "dls2_dcsconfig depends on python"
		depends on !BR2_PACKAGE_PYTHON
```

## package/DLS-2/dls2_gui/Config.in
```kconfig
config BR2_PACKAGE_DLS2_GUI
	bool "dls2_gui"
	help
		This package contains DLS2 GUI

	depends on BR2_PACKAGE_DLS2_DCS && BR2_PACKAGE_QT_GUI_MODULE && BR2_PACKAGE_QT_JAVASCRIPTCORE && BR2_PACKAGE_QT_SCRIPT && BR2_PACKAGE_QT_DECLARATIVE && BR2_PACKAGE_QT_SQL_MODULE && !BR2_PACKAGE_QT_SQLITE_NONE

	comment "dls2 gui depends on dls2_dcs, QtGUI, QtJavascriptCore, QtScript, QtDeclarative, QtSQL and Qt SQLite plugin"
		depends on !(BR2_PACKAGE_DLS2_DCS && BR2_PACKAGE_QT_GUI_MODULE && BR2_PACKAGE_QT_JAVASCRIPTCORE && BR2_PACKAGE_QT_SCRIPT && BR2_PACKAGE_QT_DECLARATIVE && BR2_PACKAGE_QT_SQL_MODULE && !BR2_PACKAGE_QT_SQLITE_NONE)
```

## package/DLS-2/dls2_hwtest/Config.in
```kconfig
config BR2_PACKAGE_DLS2_HWTEST
	bool "dls2_hwtest"
	help
		This package contains DLS2 board level testing utility

	depends on BR2_PACKAGE_QT_GUI_MODULE && BR2_PACKAGE_BLUEZ_UTILS && BR2_PACKAGE_WIRELESS_TOOLS_LIB

	comment "dls2_hwtest depends on Qt-GUI, Bluez-Utils and Wireless Tools"
		depends on !(BR2_PACKAGE_QT_GUI_MODULE && BR2_PACKAGE_BLUEZ_UTILS && BR2_PACKAGE_WIRELESS_TOOLS_LIB)
```

## package/DLS-2/dls2_web/Config.in
```kconfig
config BR2_PACKAGE_DLS2_WEB
	bool "dls2_web"
	select BR2_PACKAGE_PYTHON_SETUPTOOLS
	help
	  DLS-2 web engine

	depends on BR2_PACKAGE_PYTHON && BR2_PACKAGE_PYTHON_CHERRYPY && BR2_PACKAGE_SURPC_PYTHON && BR2_PACKAGE_PYTHON_SIMPLEJSON

	comment "dls2_web depends on python, python-cherrypy and surpc-python module"
		depends on !BR2_PACKAGE_PROTOBUF || !BR2_PACKAGE_PYTHON || !BR2_PACKAGE_PYTHON_CHERRYPY || !BR2_PACKAGE_SURPC_PYTHON || !BR2_PACKAGE_PYTHON_SIMPLEJSON
```

## package/DLS/Config.in
```kconfig
menu "DLS"
source "package/DLS/icm/Config.in"
source "package/DLS/ddg/Config.in"
source "package/DLS/ddgd/Config.in"
endmenu
```

## package/DLS/ddg/Config.in
```kconfig
config BR2_PACKAGE_DDG
	bool "dls-device-gui"
	help
		This package contains DLS GUI.

	depends on (BR2_PACKAGE_QT && BR2_PACKAGE_BOOST && BR2_PACKAGE_BOOST_SYSTEM && BR2_PACKAGE_BOOST_DATE_TIME && BR2_PACKAGE_ACE && BR2_PACKAGE_ICM && BR2_PACKAGE_DDGD && BR2_PACKAGE_QT_STL)

	comment "dls-device-gui depends on: QT(with STL), BOOST(System, Date_Time), ACE, ICM, DDGD"
		depends on !(BR2_PACKAGE_QT && BR2_PACKAGE_BOOST && BR2_PACKAGE_BOOST_SYSTEM && BR2_PACKAGE_BOOST_DATE_TIME && BR2_PACKAGE_ACE && BR2_PACKAGE_ICM && BR2_PACKAGE_DDGD && BR2_PACKAGE_QT_STL)
```

## package/DLS/ddgd/Config.in
```kconfig
config BR2_PACKAGE_DDGD
	bool "dls-device-gui qml designs"
	help
		This package contains DLS GUI QML designs.
```
