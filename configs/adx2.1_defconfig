## configs/adx2.1_defconfig
```kconfig
BR2_arm=y
BR2_cortex_a9=y
BR2_JLEVEL=15
BR2_OPTIMIZE_3=y
BR2_KERNEL_HEADERS_VERSION=y
BR2_DEFAULT_KERNEL_VERSION="3.1.10"
BR2_UCLIBC_CONFIG="toolchain/uClibc/uClibc-0.9.33-ADX2.1.config"
BR2_GCC_VERSION_4_7_X=y
BR2_EXTRA_GCC_CONFIG_OPTIONS="--with-fpu=vfpv3-d16"
BR2_PACKAGE_GDB=y
# BR2_SOFT_FLOAT is not set
BR2_TARGET_OPTIMIZATION="-pipe -march=armv7-a -mfloat-abi=softfp -mfpu=vfpv3-d16 -mtune=cortex-a9 -O3"
BR2_TOOLCHAIN_BUILDROOT_LARGEFILE=y
BR2_TOOLCHAIN_BUILDROOT_WCHAR=y
BR2_TOOLCHAIN_BUILDROOT_CXX=y
BR2_TARGET_GENERIC_HOSTNAME="monitor"
BR2_TARGET_GENERIC_ISSUE="Welcome to the Rover Monitor"
BR2_ROOTFS_SKELETON_CUSTOM=y
BR2_ROOTFS_SKELETON_CUSTOM_PATH="fs/skeleton-ADX2.1"
BR2_PACKAGE_BUSYBOX_CONFIG="package/busybox/busybox-1.20.x-ADX2.1.config"
BR2_PACKAGE_GSTREAMER=y
BR2_PACKAGE_GST_PLUGINS_GOOD=y
BR2_PACKAGE_GST_PLUGINS_GOOD_JPEG=y
BR2_PACKAGE_BZIP2=y
BR2_PACKAGE_STRACE=y
BR2_PACKAGE_VALGRIND=y
BR2_PACKAGE_FBV=y
BR2_PACKAGE_QT=y
BR2_PACKAGE_QT_LICENSE_APPROVED=y
BR2_PACKAGE_QT_QTFREETYPE=y
BR2_PACKAGE_QT_QTJPEG=y
BR2_PACKAGE_QT_QTPNG=y
BR2_PACKAGE_QT_MOUSE_LINUXTP=y
BR2_PACKAGE_QT_MOUSE_LINUXINPUT=y
BR2_PACKAGE_QT_MOUSE_TSLIB=y
BR2_PACKAGE_QT_KEYBOARD_TTY=y
BR2_PACKAGE_QT_KEYBOARD_LINUXINPUT=y
BR2_PACKAGE_QT_PHONON_SWAP_RGB=y
BR2_PACKAGE_QT_STL=y
BR2_PACKAGE_PICOCOM=y
BR2_PACKAGE_PYTHON=y
BR2_PACKAGE_PYTHON_SERIAL=y
BR2_PACKAGE_JPEG_LEAVE_TOOLS=y
BR2_PACKAGE_OPENCV=y
# BR2_PACKAGE_OPENCV_LIB_CALIB3D is not set
# BR2_PACKAGE_OPENCV_LIB_CONTRIB is not set
# BR2_PACKAGE_OPENCV_LIB_FEATURES2D is not set
# BR2_PACKAGE_OPENCV_LIB_FLANN is not set
# BR2_PACKAGE_OPENCV_LIB_LEGACY is not set
# BR2_PACKAGE_OPENCV_LIB_ML is not set
# BR2_PACKAGE_OPENCV_LIB_OBJDETECT is not set
# BR2_PACKAGE_OPENCV_LIB_PHOTO is not set
# BR2_PACKAGE_OPENCV_LIB_STITCHING is not set
# BR2_PACKAGE_OPENCV_LIB_TS is not set
# BR2_PACKAGE_OPENCV_LIB_VIDEO is not set
# BR2_PACKAGE_OPENCV_LIB_VIDEOSTAB is not set
# BR2_PACKAGE_OPENCV_WITH_QT is not set
BR2_PACKAGE_ACE=y
BR2_PACKAGE_PCRE=y
BR2_PACKAGE_DROPBEAR=y
BR2_PACKAGE_HTOP=y
BR2_PACKAGE_KMOD=y
BR2_PACKAGE_UTIL_LINUX=y
BR2_PACKAGE_JT=y
BR2_PACKAGE_MONITOR=y
```

## configs/dls2-hwtest_defconfig
```kconfig
BR2_arm=y
BR2_cortex_a8=y
BR2_JLEVEL=10
BR2_KERNEL_HEADERS_3_1=y
BR2_TOOLCHAIN_BUILDROOT_LOCALE=y
BR2_TOOLCHAIN_BUILDROOT_CXX=y
BR2_ROOTFS_SKELETON_CUSTOM=y
BR2_ROOTFS_SKELETON_CUSTOM_PATH="fs/skeleton-dls-2-hwtest"
BR2_PACKAGE_BUSYBOX_CONFIG="package/busybox/busybox-1.20.x-DLS-2.config"
BR2_PACKAGE_FBV=y
BR2_PACKAGE_QT=y
BR2_PACKAGE_QT_LICENSE_APPROVED=y
BR2_PACKAGE_QT_QTFREETYPE=y
BR2_PACKAGE_QT_SYSTEMJPEG=y
BR2_PACKAGE_QT_SYSTEMPNG=y
BR2_PACKAGE_QT_MOUSE_TSLIB=y
# BR2_PACKAGE_QT_XML is not set
# BR2_PACKAGE_QT_SCRIPT is not set
BR2_PACKAGE_LIBERATION=y
BR2_PACKAGE_MTD=y
# BR2_PACKAGE_MTD_UBIATTACH is not set
# BR2_PACKAGE_MTD_UBICRC32 is not set
# BR2_PACKAGE_MTD_UBIDETACH is not set
# BR2_PACKAGE_MTD_UBIFORMAT is not set
# BR2_PACKAGE_MTD_UBIMKVOL is not set
# BR2_PACKAGE_MTD_UBINFO is not set
# BR2_PACKAGE_MTD_UBINIZE is not set
# BR2_PACKAGE_MTD_UBIRENAME is not set
# BR2_PACKAGE_MTD_UBIRMVOL is not set
# BR2_PACKAGE_MTD_UBIRSVOL is not set
# BR2_PACKAGE_MTD_UBIUPDATEVOL is not set
BR2_PACKAGE_PICOCOM=y
BR2_PACKAGE_SERIAL_TEST=y
BR2_PACKAGE_SERIAL_TEST_CFG_AM3354=y
BR2_PACKAGE_PYTHON=y
BR2_PACKAGE_PYTHON_SERIAL=y
BR2_PACKAGE_FONTCONFIG=y
BR2_PACKAGE_TSLIB=y
BR2_PACKAGE_BLUEZ_UTILS=y
BR2_PACKAGE_BLUEZ_UTILS_BCCMD=y
BR2_PACKAGE_BLUECORE=y
BR2_PACKAGE_BLUECORE_RESET_GPIO="55"
BR2_PACKAGE_BLUECORE_RESET_HOLD_TIME=300000
BR2_PACKAGE_BLUECORE_TTY="ttyO5"
BR2_PACKAGE_DROPBEAR=y
BR2_PACKAGE_NTP=y
# BR2_PACKAGE_NTP_NTPD is not set
BR2_PACKAGE_NTP_NTPDATE=y
BR2_PACKAGE_WIRELESS_TOOLS=y
BR2_PACKAGE_WIRELESS_TOOLS_LIB=y
BR2_PACKAGE_WPA_SUPPLICANT=y
BR2_PACKAGE_WPA_SUPPLICANT_EAP=y
BR2_PACKAGE_WPA_SUPPLICANT_CLI=y
BR2_PACKAGE_WPA_SUPPLICANT_PASSPHRASE=y
BR2_PACKAGE_WPA_SUPPLICANT_WPS=y
BR2_PACKAGE_DLS2_HWTEST=y
BR2_TARGET_ROOTFS_JFFS2=y
BR2_TARGET_ROOTFS_JFFS2_NANDFLASH_2K_128K=y
BR2_TARGET_ROOTFS_JFFS2_PAD=y
BR2_TARGET_ROOTFS_JFFS2_SUMMARY=y
```

## configs/dls2_defconfig
```kconfig
BR2_arm=y
BR2_cortex_a8=y
BR2_JLEVEL=10
BR2_KERNEL_HEADERS_3_1=y
BR2_UCLIBC_CONFIG="toolchain/uClibc/uClibc-0.9.33-dls2.config"
BR2_GCC_VERSION_4_7_X=y
BR2_EXTRA_GCC_CONFIG_OPTIONS="--with-fpu=neon"
BR2_PACKAGE_GDB=y
BR2_PACKAGE_GDB_SERVER=y
BR2_PACKAGE_GDB_HOST=y
# BR2_SOFT_FLOAT is not set
BR2_TARGET_OPTIMIZATION="-pipe -march=armv7-a -mfloat-abi=softfp -mfpu=neon -ftree-vectorize -mtune=cortex-a8 -O3"
BR2_TOOLCHAIN_BUILDROOT_LARGEFILE=y
BR2_TOOLCHAIN_BUILDROOT_WCHAR=y
BR2_TOOLCHAIN_BUILDROOT_CXX=y
BR2_ROOTFS_SKELETON_CUSTOM=y
BR2_ROOTFS_SKELETON_CUSTOM_PATH="fs/skeleton-dls-2"
BR2_PACKAGE_BUSYBOX_CONFIG="package/busybox/busybox-1.20.x-DLS-2.config"
BR2_PACKAGE_STRACE=y
BR2_PACKAGE_VALGRIND=y
# BR2_PACKAGE_VALGRIND_CACHEGRIND is not set
# BR2_PACKAGE_VALGRIND_CALLGRIND is not set
# BR2_PACKAGE_VALGRIND_HELGRIND is not set
# BR2_PACKAGE_VALGRIND_DRD is not set
# BR2_PACKAGE_VALGRIND_MASSIF is not set
# BR2_PACKAGE_VALGRIND_DHAT is not set
BR2_PACKAGE_FBV=y
BR2_PACKAGE_QT=y
BR2_PACKAGE_QT_LICENSE_APPROVED=y
BR2_PACKAGE_QT_QTFREETYPE=y
BR2_PACKAGE_QT_QTJPEG=y
BR2_PACKAGE_QT_QTPNG=y
BR2_PACKAGE_QT_SQL_MODULE=y
BR2_PACKAGE_QT_SQLITE_QT=y
BR2_PACKAGE_QT_MOUSE_TSLIB=y
BR2_PACKAGE_QT_DBUS=y
BR2_PACKAGE_QT_XMLPATTERNS=y
BR2_PACKAGE_QT_WEBKIT=y
BR2_PACKAGE_QT_STL=y
BR2_PACKAGE_QT_SCRIPTTOOLS=y
BR2_PACKAGE_QT_DECLARATIVE=y
BR2_PACKAGE_MTD=y
BR2_PACKAGE_PICOCOM=y
BR2_PACKAGE_REMSERIAL=y
BR2_PACKAGE_PYTHON=y
BR2_PACKAGE_PYTHON_PROTOBUF=y
BR2_PACKAGE_PYTHON_MAKO=y
BR2_PACKAGE_PYTHON_CHERRYPY=y
BR2_PACKAGE_CSR_WIFI_KMOD=y
BR2_PACKAGE_CSR_WIFI_USERSPACE=y
BR2_PACKAGE_TSLIB=y
BR2_PACKAGE_ACE=y
BR2_PACKAGE_BOOST=y
BR2_PACKAGE_BOOST_SYSTEM=y
BR2_PACKAGE_PROTOBUF=y
BR2_PACKAGE_BLUEZ_UTILS=y
BR2_PACKAGE_BLUEZ_UTILS_COMPAT=y
BR2_PACKAGE_BLUEZ_UTILS_BCCMD=y
BR2_PACKAGE_BLUECORE=y
BR2_PACKAGE_BLUECORE_RESET_GPIO="55"
BR2_PACKAGE_BLUECORE_RESET_HOLD_TIME=300000
BR2_PACKAGE_BLUECORE_TTY="ttyO5"
BR2_PACKAGE_DROPBEAR=y
BR2_PACKAGE_NTP=y
# BR2_PACKAGE_NTP_NTPD is not set
BR2_PACKAGE_NTP_NTPDATE=y
BR2_PACKAGE_WIRELESS_TOOLS=y
BR2_PACKAGE_WIRELESS_TOOLS_LIB=y
BR2_PACKAGE_WPA_SUPPLICANT=y
BR2_PACKAGE_WPA_SUPPLICANT_EAP=y
BR2_PACKAGE_WPA_SUPPLICANT_CLI=y
BR2_PACKAGE_WPA_SUPPLICANT_PASSPHRASE=y
BR2_PACKAGE_WPA_SUPPLICANT_WPS=y
BR2_PACKAGE_HTOP=y
BR2_PACKAGE_SURPC=y
BR2_PACKAGE_SURPC_PYTHON=y
BR2_PACKAGE_DLS2_DCS=y
BR2_PACKAGE_DLS2_DCSCONFIG=y
BR2_PACKAGE_DLS2_GUI=y
BR2_TARGET_ROOTFS_UBIFS=y
BR2_TARGET_ROOTFS_UBIFS_LEBSIZE=0x1f000
BR2_TARGET_ROOTFS_UBIFS_MAXLEBCNT=820
BR2_TARGET_UBOOT=y
BR2_TARGET_UBOOT_BOARDNAME="dls2"
BR2_TARGET_UBOOT_CUSTOM_GIT=y
BR2_TARGET_UBOOT_CUSTOM_GIT_REPO_URL="ssh://merlin:29418/tx48/u-boot.git"
BR2_TARGET_UBOOT_CUSTOM_GIT_VERSION="stable-dls-2"
BR2_TARGET_UBOOT_FORMAT_IMG=y
BR2_TARGET_UBOOT_SPL=y
BR2_TARGET_UBOOT_SPL_NAME="MLO"
BR2_LINUX_KERNEL=y
BR2_LINUX_KERNEL_CUSTOM_GIT=y
BR2_LINUX_KERNEL_CUSTOM_GIT_REPO_URL="ssh://merlin:29418/tx48/linux.git"
BR2_LINUX_KERNEL_CUSTOM_GIT_VERSION="stable-dls-2"
BR2_LINUX_KERNEL_DEFCONFIG="dls2"
```

## configs/ftt_tx-dali_defconfig
```kconfig
BR2_arm=y
BR2_JLEVEL=10
BR2_KERNEL_HEADERS_3_2=y
BR2_UCLIBC_CONFIG="board/ftt_tx-dali/uClibc-0.9.33.config"
BR2_TOOLCHAIN_BUILDROOT_LARGEFILE=y
BR2_TOOLCHAIN_BUILDROOT_LOCALE=y
BR2_PTHREAD_DEBUG=y
BR2_TOOLCHAIN_BUILDROOT_CXX=y
BR2_TARGET_GENERIC_HOSTNAME="ftt_tt"
BR2_TARGET_GENERIC_ISSUE="Welcome to FTT_TX"
BR2_ROOTFS_DEVICE_TABLE="board/ftt_tx-dali/device_table.txt"
BR2_TARGET_GENERIC_ROOT_PASSWD="gandalf"
BR2_TARGET_GENERIC_GETTY_PORT="ttyAMA0"
BR2_ROOTFS_OVERLAY="board/ftt_tx-dali/overlay"
BR2_ROOTFS_POST_BUILD_SCRIPT="board/ftt_tx-dali/scripts/add_runit_to_inittab"
BR2_LINUX_KERNEL=y
BR2_LINUX_KERNEL_CUSTOM_GIT=y
BR2_LINUX_KERNEL_CUSTOM_REPO_URL="ssh://merlin.swind.sk:29418/tx28/linux.git"
BR2_LINUX_KERNEL_CUSTOM_REPO_VERSION="ftt_tx"
BR2_LINUX_KERNEL_DEFCONFIG="ftt_tx"
BR2_PACKAGE_BUSYBOX_CONFIG="board/ftt_tx-dali/busybox-1.21.x.config"
BR2_PACKAGE_BUSYBOX_WATCHDOG=y
BR2_PACKAGE_PERF=y
BR2_PACKAGE_STRACE=y
BR2_PACKAGE_MTD=y
BR2_PACKAGE_FBV=y
BR2_PACKAGE_QT=y
BR2_PACKAGE_QT_LICENSE_APPROVED=y
BR2_PACKAGE_QT_QTFREETYPE=y
BR2_PACKAGE_QT_GIF=y
BR2_PACKAGE_QT_LIBMNG=y
BR2_PACKAGE_QT_QTJPEG=y
BR2_PACKAGE_QT_SYSTEMPNG=y
BR2_PACKAGE_QT_SYSTEMTIFF=y
BR2_PACKAGE_QT_SQL_MODULE=y
BR2_PACKAGE_QT_SQLITE_QT=y
BR2_PACKAGE_QT_MOUSE_TSLIB=y
BR2_PACKAGE_QT_SVG=y
BR2_PACKAGE_QT_WEBKIT=y
BR2_PACKAGE_QT_STL=y
BR2_PACKAGE_QT_SCRIPTTOOLS=y
BR2_PACKAGE_QT_DECLARATIVE=y
BR2_PACKAGE_I2C_TOOLS=y
BR2_PACKAGE_I2C_TOOLS_DEV=y
BR2_PACKAGE_PICOCOM=y
BR2_PACKAGE_PYTHON=y
BR2_PACKAGE_PYTHON_SQLITE=y
BR2_PACKAGE_PYTHON_MAKO=y
BR2_PACKAGE_PYTHON_CHERRYPY=y
BR2_PACKAGE_TSLIB=y
BR2_PACKAGE_ACE=y
BR2_PACKAGE_BOOST=y
BR2_PACKAGE_BOOST_REGEX=y
BR2_PACKAGE_BOOST_SIGNALS=y
BR2_PACKAGE_BOOST_SYSTEM=y
BR2_PACKAGE_ELFUTILS=y
BR2_PACKAGE_LINUX_PAM=y
BR2_PACKAGE_PROTOBUF=y
BR2_PACKAGE_DROPBEAR=y
BR2_PACKAGE_LINKS=y
BR2_PACKAGE_NTP=y
BR2_PACKAGE_NTP_NTPDATE=y
BR2_PACKAGE_HTOP=y
BR2_PACKAGE_UTIL_LINUX=y
BR2_PACKAGE_UTIL_LINUX_LIBMOUNT=y
BR2_PACKAGE_SURPC=y
BR2_PACKAGE_DLS2_VERSION="light"
BR2_PACKAGE_DLS2_DCS=y
# BR2_PACKAGE_DLS2_DCS_FW_UPDATE is not set
BR2_PACKAGE_DLS2_DCS_TARGET_PLATFORM_FTT_TX=y
BR2_PACKAGE_DLS2_DCSCONFIG=y
BR2_PACKAGE_DLS2_GUI=y
BR2_PACKAGE_OPENBOX_TEMPLATES=y
BR2_TARGET_ROOTFS_UBIFS=y
BR2_TARGET_ROOTFS_UBIFS_LEBSIZE=0x1f000
BR2_TARGET_ROOTFS_UBIFS_MAXLEBCNT=830
BR2_TARGET_UBOOT=y
BR2_TARGET_UBOOT_BOARDNAME="ftt_tx"
BR2_TARGET_UBOOT_CUSTOM_GIT=y
BR2_TARGET_UBOOT_CUSTOM_REPO_URL="ssh://merlin.swind.sk:29418/tx28/u-boot.git"
BR2_TARGET_UBOOT_CUSTOM_REPO_VERSION="master"
BR2_TARGET_UBOOT_FORMAT_SB=y
```

## configs/ftt_tx_defconfig
```kconfig
BR2_arm=y
BR2_JLEVEL=10
BR2_KERNEL_HEADERS_3_2=y
BR2_UCLIBC_CONFIG="board/ftt_tx/uClibc-0.9.33.config"
BR2_TOOLCHAIN_BUILDROOT_LARGEFILE=y
BR2_TOOLCHAIN_BUILDROOT_LOCALE=y
BR2_PTHREAD_DEBUG=y
BR2_TOOLCHAIN_BUILDROOT_CXX=y
BR2_TARGET_GENERIC_HOSTNAME="ftt_tt"
BR2_TARGET_GENERIC_ISSUE="Welcome to FTT_TX"
BR2_ROOTFS_DEVICE_TABLE="board/ftt_tx/device_table.txt"
BR2_TARGET_GENERIC_ROOT_PASSWD="gandalf"
BR2_TARGET_GENERIC_GETTY_PORT="ttyAMA0"
BR2_ROOTFS_OVERLAY="board/ftt_tx/overlay"
BR2_ROOTFS_POST_BUILD_SCRIPT="board/ftt_tx/scripts/add_runit_to_inittab board/ftt_tx/scripts/setup_users"
BR2_LINUX_KERNEL=y
BR2_LINUX_KERNEL_CUSTOM_GIT=y
BR2_LINUX_KERNEL_CUSTOM_REPO_URL="ssh://merlin.swind.sk:29418/tx28/linux.git"
BR2_LINUX_KERNEL_CUSTOM_REPO_VERSION="ftt_tx"
BR2_LINUX_KERNEL_DEFCONFIG="ftt_tx"
BR2_LINUX_KERNEL_INSTALL_TARGET=y
BR2_PACKAGE_BUSYBOX_CONFIG="board/ftt_tx/busybox-1.21.x.config"
BR2_PACKAGE_BUSYBOX_WATCHDOG=y
BR2_PACKAGE_PERF=y
BR2_PACKAGE_MTD=y
BR2_PACKAGE_FBV=y
BR2_PACKAGE_QT=y
BR2_PACKAGE_QT_LICENSE_APPROVED=y
BR2_PACKAGE_QT_QTFREETYPE=y
BR2_PACKAGE_QT_GIF=y
BR2_PACKAGE_QT_LIBMNG=y
BR2_PACKAGE_QT_QTJPEG=y
BR2_PACKAGE_QT_SYSTEMPNG=y
BR2_PACKAGE_QT_SYSTEMTIFF=y
BR2_PACKAGE_QT_MOUSE_TSLIB=y
BR2_PACKAGE_QT_SVG=y
BR2_PACKAGE_QT_WEBKIT=y
BR2_PACKAGE_QT_STL=y
BR2_PACKAGE_QT_SCRIPTTOOLS=y
BR2_PACKAGE_PICOCOM=y
BR2_PACKAGE_TRIPOT=y
BR2_PACKAGE_TRIPOT_DEVICE1="ttyAPP1"
BR2_PACKAGE_TRIPOT_DEVICE2="ttyAPP4"
BR2_PACKAGE_OPENDAF=y
BR2_PACKAGE_OPENDAF_STARTUP_RUNIT=y
BR2_PACKAGE_UHMI=y
BR2_PACKAGE_UHMI_SCAN_PERIOD=500
BR2_PACKAGE_UHMI_DEMOS=y
BR2_PACKAGE_PYTHON=y
BR2_PACKAGE_PYTHON_SQLITE=y
BR2_PACKAGE_PYTHON_MAKO=y
BR2_PACKAGE_PYTHON_CHERRYPY=y
BR2_PACKAGE_TSLIB=y
BR2_PACKAGE_ACE=y
BR2_PACKAGE_BOOST=y
BR2_PACKAGE_BOOST_REGEX=y
BR2_PACKAGE_BOOST_SIGNALS=y
BR2_PACKAGE_BOOST_SYSTEM=y
BR2_PACKAGE_ELFUTILS=y
BR2_PACKAGE_DROPBEAR=y
BR2_PACKAGE_LINKS=y
BR2_PACKAGE_NETSNMP=y
BR2_PACKAGE_NTP=y
BR2_PACKAGE_NTP_NTPDATE=y
BR2_PACKAGE_NTP_NTPQ=y
BR2_PACKAGE_HTOP=y
BR2_PACKAGE_UTIL_LINUX=y
BR2_PACKAGE_UTIL_LINUX_BINARIES=y
BR2_PACKAGE_UTIL_LINUX_CHFN_CHSH=y
BR2_TARGET_ROOTFS_UBIFS=y
BR2_TARGET_ROOTFS_UBIFS_LEBSIZE=0x1f000
BR2_TARGET_ROOTFS_UBIFS_MAXLEBCNT=830
BR2_TARGET_UBOOT=y
BR2_TARGET_UBOOT_BOARDNAME="ftt_tx"
BR2_TARGET_UBOOT_CUSTOM_GIT=y
BR2_TARGET_UBOOT_CUSTOM_REPO_URL="ssh://merlin.swind.sk:29418/tx28/u-boot.git"
BR2_TARGET_UBOOT_CUSTOM_REPO_VERSION="master"
BR2_TARGET_UBOOT_FORMAT_SB=y
```

## configs/ha2_defconfig
```kconfig
BR2_arm=y
BR2_JLEVEL=10
BR2_KERNEL_HEADERS_3_2=y
BR2_UCLIBC_CONFIG="board/ha2/uClibc-0.9.33.config"
BR2_TOOLCHAIN_BUILDROOT_LARGEFILE=y
BR2_TOOLCHAIN_BUILDROOT_LOCALE=y
BR2_TOOLCHAIN_BUILDROOT_CXX=y
BR2_PTHREAD_DEBUG=y
BR2_TARGET_GENERIC_HOSTNAME="ha2"
BR2_TARGET_GENERIC_ISSUE="Welcome to HA2"
BR2_TARGET_GENERIC_ROOT_PASSWD="gandalf"
BR2_TARGET_GENERIC_GETTY_PORT="ttyAMA0"
BR2_ROOTFS_OVERLAY="board/ha2/overlay"
BR2_ROOTFS_POST_BUILD_SCRIPT="board/ha2/scripts/add_runit_to_inittab"
BR2_PACKAGE_BUSYBOX_CONFIG="board/ha2/busybox-1.21.x.config"
BR2_PACKAGE_BUSYBOX_WATCHDOG=y
BR2_PACKAGE_STRACE=y
BR2_PACKAGE_MTD=y
BR2_PACKAGE_PICOCOM=y
BR2_PACKAGE_TSLIB=y
BR2_PACKAGE_ACE=y
BR2_PACKAGE_BOOST=y
BR2_PACKAGE_BOOST_SIGNALS=y
BR2_PACKAGE_BOOST_SYSTEM=y
BR2_PACKAGE_DROPBEAR=y
BR2_PACKAGE_NTP=y
# BR2_PACKAGE_NTP_NTPD is not set
BR2_PACKAGE_NTP_NTPDATE=y
BR2_PACKAGE_HA2_OPENSMC=y
BR2_PACKAGE_HA2_OPENSMC_STARTUP_RUNIT=y
BR2_TARGET_ROOTFS_UBIFS=y
BR2_TARGET_ROOTFS_UBIFS_LEBSIZE=0x1f000
BR2_TARGET_ROOTFS_UBIFS_MAXLEBCNT=820
BR2_TARGET_ROOTFS_UBIFS_RT_NONE=y
BR2_TARGET_UBOOT=y
BR2_TARGET_UBOOT_BOARDNAME="ha2"
BR2_TARGET_UBOOT_CUSTOM_GIT=y
BR2_TARGET_UBOOT_CUSTOM_GIT_REPO_URL="ssh://merlin.swind.sk:29418/tx28/u-boot.git"
BR2_TARGET_UBOOT_CUSTOM_GIT_VERSION="ha2"
BR2_TARGET_UBOOT_FORMAT_SB=y
BR2_LINUX_KERNEL=y
BR2_LINUX_KERNEL_CUSTOM_GIT=y
BR2_LINUX_KERNEL_CUSTOM_GIT_REPO_URL="ssh://merlin.swind.sk:29418/tx28/linux.git"
BR2_LINUX_KERNEL_CUSTOM_GIT_VERSION="ha2"
BR2_LINUX_KERNEL_DEFCONFIG="ha2"
```

## configs/pdok_defconfig
```kconfig
BR2_arm=y
BR2_JLEVEL=10
BR2_KERNEL_HEADERS_3_2=y
BR2_UCLIBC_CONFIG="board/pdok/uClibc-0.9.33.config"
BR2_TOOLCHAIN_BUILDROOT_LARGEFILE=y
BR2_TOOLCHAIN_BUILDROOT_LOCALE=y
BR2_TOOLCHAIN_BUILDROOT_CXX=y
BR2_PTHREAD_DEBUG=y
BR2_TARGET_GENERIC_HOSTNAME="pdok"
BR2_TARGET_GENERIC_ISSUE="Welcome to PDOK"
BR2_ROOTFS_DEVICE_TABLE="board/pdok/device_table.txt"
BR2_TARGET_GENERIC_ROOT_PASSWD="gandalf"
BR2_TARGET_GENERIC_GETTY_PORT="ttyAMA0"
BR2_ROOTFS_OVERLAY="board/pdok/overlay"
BR2_ROOTFS_POST_BUILD_SCRIPT="board/pdok/scripts/add_runit_to_inittab board/pdok/scripts/setup_users"
BR2_PACKAGE_BUSYBOX_CONFIG="board/pdok/busybox-1.21.x.config"
BR2_PACKAGE_BUSYBOX_WATCHDOG=y
BR2_PACKAGE_PERF=y
BR2_PACKAGE_FBV=y
BR2_PACKAGE_MTD=y
BR2_PACKAGE_PICOCOM=y
BR2_PACKAGE_PYTHON=y
BR2_PACKAGE_PYTHON_MAKO=y
BR2_PACKAGE_PYTHON_CHERRYPY=y
BR2_PACKAGE_TSLIB=y
BR2_PACKAGE_ACE=y
BR2_PACKAGE_ELFUTILS=y
BR2_PACKAGE_BOOST=y
BR2_PACKAGE_BOOST_REGEX=y
BR2_PACKAGE_BOOST_SIGNALS=y
BR2_PACKAGE_BOOST_SYSTEM=y
BR2_PACKAGE_DROPBEAR=y
BR2_PACKAGE_LINKS=y
BR2_PACKAGE_NETSNMP=y
BR2_PACKAGE_NTP=y
BR2_PACKAGE_NTP_NTPDATE=y
BR2_PACKAGE_OPENDAF=y
BR2_PACKAGE_OPENDAF_PLATFORM="openbox"
BR2_PACKAGE_OPENDAF_STARTUP_RUNIT=y
BR2_PACKAGE_HTOP=y
BR2_PACKAGE_UTIL_LINUX=y
BR2_PACKAGE_UTIL_LINUX_BINARIES=y
BR2_PACKAGE_UTIL_LINUX_CHFN_CHSH=y
BR2_PACKAGE_OPENBOX_WEBADMIN=y
BR2_PACKAGE_OPENBOX_WEBADMIN_STARTUP_RUNIT=y
BR2_TARGET_ROOTFS_UBIFS=y
BR2_TARGET_ROOTFS_UBIFS_LEBSIZE=0x1f000
BR2_TARGET_ROOTFS_UBIFS_MAXLEBCNT=830
BR2_TARGET_UBOOT=y
BR2_TARGET_UBOOT_BOARDNAME="pdok"
BR2_TARGET_UBOOT_CUSTOM_GIT=y
BR2_TARGET_UBOOT_CUSTOM_GIT_REPO_URL="ssh://merlin.swind.sk:29418/tx28/u-boot.git"
BR2_TARGET_UBOOT_CUSTOM_GIT_VERSION="master"
BR2_TARGET_UBOOT_FORMAT_SB=y
BR2_LINUX_KERNEL=y
BR2_LINUX_KERNEL_CUSTOM_GIT=y
BR2_LINUX_KERNEL_CUSTOM_GIT_REPO_URL="ssh://merlin.swind.sk:29418/tx28/linux.git"
BR2_LINUX_KERNEL_CUSTOM_GIT_VERSION="master"
BR2_LINUX_KERNEL_DEFCONFIG="pdok"
```
