## package/rtuadmin/rtuadmin-client/Config.in
```kconfig
config BR2_PACKAGE_RTUADMIN_CLIENT
	bool "rtuadmin-client"
	select BR2_PACKAGE_WEBDAF
	help
		This package contains RTUAdmin client.
```

## package/rtuadmin/rtuadmin-rang/Config.in
```kconfig
config BR2_PACKAGE_RTUADMIN_RANG
	bool "rang"
	depends on BR2_PACKAGE_DCRON && BR2_PACKAGE_JQ && BR2_PACKAGE_WGET && BR2_PACKAGE_GETENT
	default y
	help
	  Next-generation RTU administration system

if BR2_PACKAGE_RTUADMIN_RANG
	config BR2_PACKAGE_RTUADMIN_RANG_CGI
		bool "install CGI wrapper"
		default y

endif

comment "rang depends on dcron, jq, wget & getent"
	depends on !(BR2_PACKAGE_DCRON && BR2_PACKAGE_JQ && BR2_PACKAGE_WGET && BR2_PACKAGE_GETENT)
```

## package/rtuadmin/rtuadmin-server/Config.in
```kconfig
config BR2_PACKAGE_RTUADMIN_SERVER
	bool "rtuadmin-server"
	depends on BR2_PACKAGE_CJSON && BR2_PACKAGE_SQLITE && BR2_PACKAGE_LUA && BR2_PACKAGE_COSMO
	help
		This package contains RTU admin server.

comment "rtuadmin-server depends on cJSON, sqlite, lua and lua-cosmo"
	depends on !(BR2_PACKAGE_CJSON && BR2_PACKAGE_SQLITE && BR2_PACKAGE_LUA && BR2_PACKAGE_COSMO)
```

## package/rtuadmin/rtuadmin-templates/Config.in
```kconfig
config BR2_PACKAGE_RTUADMIN_TEMPLATES
	bool "rtuadmin-templates"
	help
	  RTUAdmin system templates
```

## package/serial_test/Config.in
```kconfig
config BR2_PACKAGE_SERIAL_TEST
	bool "serial_test"
	help
		This package contains simple serial port testing utility

	depends on BR2_PACKAGE_PYTHON_SERIAL

	comment "serial_test depends on python-serial"
		depends on !BR2_PACKAGE_PYTHON_SERIAL

choice
	prompt "serial_test configuration"
	default BR2_PACKAGE_SERIAL_TEST_CFG_NONE
	depends on BR2_PACKAGE_SERIAL_TEST

config BR2_PACKAGE_SERIAL_TEST_CFG_NONE
	bool "No configuration"

config BR2_PACKAGE_SERIAL_TEST_CFG_IMX28
	bool "Freescale i.mx28 ttyAPP0-4 configuration"

endchoice
```

## package/simpledb/Config.in
```kconfig
config BR2_PACKAGE_SIMPLEDB
	bool "SimpleDB"
	select BR2_PACKAGE_UNIXODBC
	help
	  Simple C++ ODBC wrapper.
```

## package/simplemail/Config.in
```kconfig
config BR2_PACKAGE_SIMPLEMAIL
	bool "simplemail"
	depends on BR2_PACKAGE_HEIRLOOM_MAILX
	help
	  Simple heirloom-mailx wrapper

comment "simplemail depends on heirloom-mailx"
	depends on !BR2_PACKAGE_HEIRLOOM_MAILX
```

## package/soci/Config.in
```kconfig
config BR2_PACKAGE_SOCI
	bool "soci"
	depends on BR2_PACKAGE_ACE && BR2_PACKAGE_BOOST_SYSTEM && BR2_PACKAGE_BOOST_SIGNALS
	help
		SOCI is a database access library for C++ that makes the illusion
		of embedding SQL queries in the regular C++ code, staying entirely
		within the Standard C++.

		http://soci.sourceforge.net/

if BR2_PACKAGE_SOCI
	config BR2_PACKAGE_SOCI_BOOST_INTEGRATION
		bool "Boost integration"
		default y
		depends on BR2_PACKAGE_BOOST && BR2_PACKAGE_BOOST_DATE_TIME

	comment "Boost integration requires boost and boost-date_time"
		depends on !(BR2_PACKAGE_BOOST && BR2_PACKAGE_BOOST_DATE_TIME)

	config BR2_PACKAGE_SOCI_BACKEND_MYSQL
		bool "MySQL backend"
		default y
		depends on BR2_PACKAGE_MYSQL

	comment "MySQL backend depends on mysql (client-side only)"
		depends on !BR2_PACKAGE_MYSQL

	config BR2_PACKAGE_SOCI_BACKEND_SQLITE
		bool "SQLite backend"
		default y
		depends on BR2_PACKAGE_SQLITE

	comment "SQLite backend depends on sqlite"
		depends on !BR2_PACKAGE_SQLITE

	config BR2_PACKAGE_SOCI_BACKEND_ODBC
		bool "ODBC backend"
		default y
		depends on BR2_PACKAGE_UNIXODBC

	comment "ODBC backend depends on unixodbc"
		depends on !BR2_PACKAGE_UNIXODBC

endif
```

## package/systemtest/Config.in
```kconfig
config BR2_PACKAGE_SYSTEMTEST
	bool "systemtest"
	depends on BR2_MACHINE != ""
	help
	  Machine-specific systemtest.

comment "systemtest requires non-empty BR2_MACHINE"
	depends on BR2_MACHINE = ""
```

## package/tripot/Config.in
```kconfig
config BR2_PACKAGE_TRIPOT
	bool "tripot"
	help
		Sample 3x potentiometer 1x progressbar serial port application

	depends on BR2_PACKAGE_QT_GUI_MODULE

	comment "tripot depends on QT gui module"
		depends on !BR2_PACKAGE_QT_GUI_MODULE

if BR2_PACKAGE_TRIPOT

    config BR2_PACKAGE_TRIPOT_DEVICE1
        string "serial device to use?"
        default "ttyAPP0"
        help
          Serial device file name to be used, without /dev prefix.

    config BR2_PACKAGE_TRIPOT_DEVICE2
        string "serial device to use?"
        default "ttyAPP3"
        help
          Serial device file name to be used, without /dev prefix.

	choice
		prompt "Display resolution"
		depends on BR2_PACKAGE_TRIPOT
		default BR2_PACKAGE_TRIPOT_RESOLUTION_480x272
		
		config BR2_PACKAGE_TRIPOT_RESOLUTION_480x272
			bool "480x272"
		
		config BR2_PACKAGE_TRIPOT_RESOLUTION_800x480
			bool "800x480"

	endchoice

endif
```

## package/tzconfig/Config.in
```kconfig
config BR2_PACKAGE_TZCONFIG
	bool "tzconfig cgi wrapper"
	help
	  Timezone list/get/set CGI wrapper script
```

## package/uHMI-demos/Config.in
```kconfig
config BR2_PACKAGE_UHMI_DEMOS
	bool "uHMI demos"
	depends on BR2_PACKAGE_UHMI
	help
	  Micro Human Machine Interface demos

if BR2_PACKAGE_UHMI_DEMOS
	config BR2_PACKAGE_UHMI_DEMOS_DEMO
	string "Demo to build"
	default koyo
	depends on BR2_PACKAGE_UHMI_DEMOS
	help
		Which uHMI demo to build & install

	config BR2_PACKAGE_UHMI_DEMOS_INDEX
	string "Where to point the index.html"
	depends on BR2_PACKAGE_UHMI_DEMOS
	help
		Path where to point the index.html.

endif

comment "uHMI depends on uHMI"
	depends on !BR2_PACKAGE_UHMI
```

## package/uHMI/Config.in
```kconfig
config BR2_PACKAGE_UHMI
	bool "uHMI"
	depends on BR2_PACKAGE_OPENDAF
	help
	  Micro Human Machine Interface

if BR2_PACKAGE_UHMI
	config BR2_PACKAGE_UHMI_SCAN_PERIOD
	int "Scan period [ms]"
	default 200
	depends on BR2_PACKAGE_UHMI
	help
		uHMI scan period in milliseconds. Use 1000 ms on slower hardware.

endif

comment "uHMI depends on OpenDAF"
	depends on !BR2_PACKAGE_OPENDAF
```

## package/wavegen/Config.in
```kconfig
config BR2_PACKAGE_WAVEGEN
	bool "Wavegen"
	depends on BR2_PACKAGE_PYTHON
	help
	  Waveform generator tool

comment "Wavegen depends on pthon"
	depends on !BR2_PACKAGE_PYTHON
```

## package/webdaf/Config.in
```kconfig
config BR2_PACKAGE_WEBDAF
	bool "webdaf"
	help
		This package contains WebDAF management interface.
```
