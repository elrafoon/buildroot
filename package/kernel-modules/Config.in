## package/kernel-modules/Config.in
```kconfig
if BR2_LINUX_KERNEL
menu "Kernel modules"
source "package/kernel-modules/csr-wifi/Config.in"
endmenu
endif
```

## package/kernel-modules/csr-wifi/Config.in
```kconfig
config BR2_PACKAGE_CSR_WIFI_KMOD
	bool "CSR wifi kernel module"
	depends on BR2_LINUX_KERNEL
	help
	  CSR wifi driver kernel module.


if BR2_arm
config BR2_PACKAGE_CSR_WIFI_USERSPACE
	bool "CSR wifi binary userspace components"
	help
	  CSR wifi driver userspace binaries & scripts.
endif
```

## package/kvds/Config.in
```kconfig
config BR2_PACKAGE_KVDS
	bool "kvds"
	depends on BR2_PACKAGE_COREUTILS
	help
	  Filesystem-based Key-Value datastore written in dash

if BR2_PACKAGE_KVDS
	config BR2_PACKAGE_KVDS_CGI
		bool "install CGI wrapper"
		default y

endif
```

## package/linuxptp/Config.in
```kconfig
config BR2_PACKAGE_LINUXPTP
	bool "linuxptp"
	help
	  This software is an implementation of the Precision Time Protocol (PTP)
	  according to IEEE standard 1588 for Linux

	  http://linuxptp.sourceforge.net/
```

## package/mod/Config.in
```kconfig
source "package/mod/mod-rtu/Config.in"
source "package/mod/mod-dave/Config.in"
source "package/mod/mod-falcon/Config.in"
source "package/mod/mod-wirt/Config.in"
source "package/mod/mod-bios/Config.in"
```

## package/mod/mod-bios/Config.in
```kconfig
config BR2_PACKAGE_MOD_BIOS
	bool "mod-bios"
	select BR2_PACKAGE_MTD
	select BR2_PACKAGE_DROPBEAR
	select BR2_PACKAGE_LRZSZ
	select BR2_PACKAGE_VSFTPD
	select BR2_PACKAGE_FWUPDATE
	depends on BR2_PACKAGE_E2FSPROGS && BR2_PACKAGE_E2FSPROGS_RESIZE2FS && BR2_PACKAGE_GNUPG && BR2_PACKAGE_GNUPG_RSA && BR2_PACKAGE_SYSTEMTEST


comment "mod-bios depends on e2fsprogs with resize2fs, gnupg with rsa support and systemtest"
	depends on !(BR2_PACKAGE_E2FSPROGS && BR2_PACKAGE_E2FSPROGS_RESIZE2FS && BR2_PACKAGE_GNUPG && BR2_PACKAGE_GNUPG_RSA && BR2_PACKAGE_SYSTEMTEST)
```

## package/mod/mod-dave/Config.in
```kconfig
config BR2_PACKAGE_MOD_DAVE
	bool "mod-dave"
	depends on BR2_PACKAGE_MOD_RTU


config BR2_PACKAGE_MOD_DAVE_BRAND
	string "brand"
	default "dave"
	depends on BR2_PACKAGE_MOD_DAVE


comment "mod-dave depends on mod-rtu"
	depends on !BR2_PACKAGE_MOD_RTU
```

## package/mod/mod-falcon/Config.in
```kconfig
config BR2_PACKAGE_MOD_FALCON
	bool "mod-falcon"
	depends on BR2_PACKAGE_ASTROCLOCK && BR2_PACKAGE_CRONTAB_CGI && BR2_PACKAGE_MOD_RTU


comment "mod-falcon depends on astroclock, crontab-cgi and mod-rtu"
	depends on !(BR2_PACKAGE_ASTROCLOCK && BR2_PACKAGE_CRONTAB_CGI && BR2_PACKAGE_MOD_RTU)
```

## package/mod/mod-rtu/Config.in
```kconfig
config BR2_PACKAGE_MOD_RTU
	bool "mod-rtu"
	depends on BR2_PACKAGE_LIGHTTPD && BR2_PACKAGE_DCRON && BR2_PACKAGE_SYSTEMD && BR2_PACKAGE_OPENDAF


comment "mod-rtu depends on lighttpd, dcron, systemd, opendaf"
	depends on !(BR2_PACKAGE_LIGHTTPD && BR2_PACKAGE_DCRON && BR2_PACKAGE_SYSTEMD && BR2_PACKAGE_OPENDAF)
```

## package/mod/mod-wirt/Config.in
```kconfig
config BR2_PACKAGE_MOD_WIRT
	bool "mod-wirt"
	depends on BR2_PACKAGE_SYSTEMD
	help
	  Support for RF hardware


if BR2_PACKAGE_MOD_WIRT
	config BR2_PACKAGE_MOD_WIRT_FULL
		bool "install application software"
		default y
		depends on BR2_PACKAGE_MOD_RTU && BR2_PACKAGE_EXPECT
		help
		  Install full application software


	comment "mod-wirt application software depends on expect & mod-rtu"
		depends on !(BR2_PACKAGE_MOD_RTU && BR2_PACKAGE_EXPECT)
endif
```

## package/modem-tools/Config.in
```kconfig
config BR2_PACKAGE_MODEM_TOOLS
	bool "modem-tools"
	help
	  Modem-related tools

if BR2_PACKAGE_MODEM_TOOLS

config BR2_PACKAGE_MODEM_TOOLS_MC
	bool "modem-check"
	depends on (BR2_PACKAGE_DCRON && BR2_PACKAGE_SYSTEMD)
	help
	  Check connection and restart modem manager when down

if BR2_PACKAGE_MODEM_TOOLS_MC
	config BR2_PACKAGE_MODEM_TOOLS_MC_PERIOD
		int "check period [m]"
		default 5
		help
		  Connection check period. Use 0 to disable periodic checks.
endif

comment "modem-check depends on dcron & systemd"
		depends on !(BR2_PACKAGE_DCRON && BR2_PACKAGE_SYSTEMD)

endif
```

## package/network-manager-openvpn/Config.in
```kconfig
config BR2_PACKAGE_NM_OPENVPN
	bool "network-manager openvpn plugin"
	depends on (BR2_PACKAGE_NETWORK_MANAGER && BR2_PACKAGE_OPENVPN)
	help
	  OpenVPN plugin for NetworkManager

comment "network-manager openvpn plugin needs network-manager and openvpn"
	depends on !(BR2_PACKAGE_NETWORK_MANAGER && BR2_PACKAGE_OPENVPN)
```

## package/nullmailer/Config.in
```kconfig
config BR2_PACKAGE_NULLMAILER
	bool "nullmailer"
	help
	  Simple relay-only mail transport agent

	  http://untroubled.org/nullmailer/

if BR2_PACKAGE_NULLMAILER
	comment "Nullmailer will be built without TLS support, because gnutls library is not enabled!"
		depends on !BR2_PACKAGE_GNUTLS


endif
```

## package/opendaf-appconf/Config.in
```kconfig
config BR2_PACKAGE_OPENDAF_APPCONF
	bool "OpenDAF-AppConf"
	depends on BR2_PACKAGE_OPENDAF
	help
		This package provides application-specific OpenDAF configurations

if BR2_PACKAGE_OPENDAF_APPCONF
	config BR2_PACKAGE_OPENDAF_APPCONF_NAME
		string "Configuration name"
		depends on BR2_PACKAGE_OPENDAF_APPCONF
		help
		  Branch or tag name in configuration repository

	config BR2_PACKAGE_OPENDAF_APPCONF_BUILTIN_FW
		bool "Build configuration into firmware"
		depends on BR2_PACKAGE_OPENDAF_APPCONF
		default y
		help
		  Enable this option to additionally install configuration into
		  /usr/share/opendaf-appconf/ directory.

endif

comment "OpenDAF-AppConf depends on OpenDAF"
	depends on !BR2_PACKAGE_OPENDAF
```

## package/opendaf/Config.in
```kconfig
config BR2_PACKAGE_OPENDAF
	bool "OpenDAF"
	depends on BR2_PACKAGE_ACE && BR2_PACKAGE_BOOST_SYSTEM && BR2_PACKAGE_BOOST_SIGNALS && BR2_PACKAGE_BOOST_REGEX && BR2_PACKAGE_NETSNMP && BR2_PACKAGE_PROTOBUF
	help
		This package contains Open Data-Acquisition Framework.

if BR2_PACKAGE_OPENDAF
	choice
		prompt "Configuration"
		default BR2_PACKAGE_OPENDAF_CFG_DEFAULT
		depends on BR2_PACKAGE_OPENDAF

		config BR2_PACKAGE_OPENDAF_CFG_DEFAULT
			bool "default"

		config BR2_PACKAGE_OPENDAF_CFG_PROD
			bool "production"

		config BR2_PACKAGE_OPENDAF_CFG_DEVEL
			bool "development"

		config BR2_PACKAGE_OPENDAF_CFG_NONE
			bool "none"

	endchoice

	choice
		prompt "Target platform"
		default BR2_PACKAGE_OPENDAF_PLATFORM_GENERIC
		depends on BR2_PACKAGE_OPENDAF

		config BR2_PACKAGE_OPENDAF_PLATFORM_GENERIC
			bool "generic"

		config BR2_PACKAGE_OPENDAF_PLATFORM_OPENBOX
			bool "openbox"

		config BR2_PACKAGE_OPENDAF_PLATFORM_RTU
			bool "rtu"
			select BR2_PACKAGE_I2C_TOOLS
			select BR2_PACKAGE_I2C_TOOLS_DEV

	endchoice

	config BR2_PACKAGE_OPENDAF_ARCHIVE
		bool "Enable archivation system"
		default y
		depends on BR2_PACKAGE_OPENDAF

	config BR2_PACKAGE_OPENDAF_DAFMAN
		bool "Build dafman management library"
		depends on BR2_PACKAGE_OPENDAF && BR2_PACKAGE_SOCI && BR2_PACKAGE_SOCI_BOOST_INTEGRATION && BR2_PACKAGE_SOCI_BACKEND_SQLITE

	comment "dafman depends on soci with boost intergration and SQLite backend"
		depends on !(BR2_PACKAGE_SOCI && BR2_PACKAGE_SOCI_BOOST_INTEGRATION && BR2_PACKAGE_SOCI_BACKEND_SQLITE)

	config BR2_PACKAGE_OPENDAF_DAFMAND
		bool "Build dafmand DBUS management daemon"
		depends on BR2_PACKAGE_OPENDAF && BR2_PACKAGE_OPENDAF_DAFMAN && BR2_PACKAGE_GLIBMM	

	comment "dafmand depends on dafman and glibmm"
		depends on !(BR2_PACKAGE_OPENDAF_DAFMAN && BR2_PACKAGE_GLIBMM)

	menu "Connector stacks"

		config BR2_PACKAGE_OPENDAF_STACK_C_GPIO
			bool gpio
			default y

			config BR2_PACKAGE_OPENDAF_GPIO_DEF
				string "GPIO definition file"
				depends on BR2_PACKAGE_OPENDAF_STACK_C_GPIO

		config BR2_PACKAGE_OPENDAF_STACK_C_IEC_104_CONTROLLING_STATION
			bool iec-104-controlling-station
			default y

		config BR2_PACKAGE_OPENDAF_STACK_C_MODBUS_RTU_MASTER
			bool modbus-rtu-master
			default y

		config BR2_PACKAGE_OPENDAF_STACK_C_MODBUS_TCP_MASTER
			bool modbus-tcp-master
			default y

		config BR2_PACKAGE_OPENDAF_STACK_C_MONEZ_CLIENT
			bool monez-client

		config BR2_PACKAGE_OPENDAF_STACK_C_O_GATE_CLIENT
			bool o_gate-client

		config BR2_PACKAGE_OPENDAF_STACK_C_OGW_NOTIFY_CLIENT
			bool ogw-notify-client

		config BR2_PACKAGE_OPENDAF_STACK_C_PANTER
			bool panter

		config BR2_PACKAGE_OPENDAF_STACK_C_PERSISTOR
			bool persistor
			default y

		config BR2_PACKAGE_OPENDAF_STACK_C_ROMET_ECS
			bool romet-ecs

		config BR2_PACKAGE_OPENDAF_STACK_C_SIGNAL_GENERATOR
			bool signal-generator
			default y

		config BR2_PACKAGE_OPENDAF_STACK_C_SQL_CLIENT_EBO_DOSIMETRY
			bool sql-client-ebo-dosimetry

		config BR2_PACKAGE_OPENDAF_STACK_C_SUHUB_NOTIFY_CLIENT
			bool suhub-notify-client

		config BR2_PACKAGE_OPENDAF_STACK_C_SWTN_CONTROLLING_STATION
			bool swtn-controlling-station

	endmenu

	menu "Provider stacks"

		config BR2_PACKAGE_OPENDAF_STACK_P_CHEMIS_SERVER
			bool chemis-server

		config BR2_PACKAGE_OPENDAF_STACK_P_DAFLINK_PROVIDER
			bool daflink-provider

		config BR2_PACKAGE_OPENDAF_STACK_P_IEC_101_CONTROLLED_STATION
			bool iec-101-controlled-station
			default y

		config BR2_PACKAGE_OPENDAF_STACK_P_IEC_104_CONTROLLED_STATION
			bool iec-104-controlled-station
			default y

		config BR2_PACKAGE_OPENDAF_STACK_P_MODBUS_RTU_SLAVE
			bool modbus-rtu-slave

		config BR2_PACKAGE_OPENDAF_STACK_P_OGW_NOTIFY_SERVER
			bool ogw-notify-server

		config BR2_PACKAGE_OPENDAF_STACK_P_SUHUB_NOTIFY_SERVER
			bool suhub-notify-server

		config BR2_PACKAGE_OPENDAF_STACK_P_SQL_PROVIDER_EBO_DOSIMETRY
			bool sql-provider-ebo-dosimetry

	endmenu

endif

comment "OpenDAF depends on ACE, boost-system, boost-signals, boost-regex, NetSNMP and Protobuf"
	depends on !(BR2_PACKAGE_ACE && BR2_PACKAGE_BOOST_SYSTEM && BR2_PACKAGE_BOOST_SIGNALS && BR2_PACKAGE_BOOST_REGEX && BR2_PACKAGE_NETSNMP && BR2_PACKAGE_PROTOBUF)
```

## package/python-cherrypy/Config.in
```kconfig
config BR2_PACKAGE_PYTHON_CHERRYPY
	bool "python-cherrypy"
	depends on BR2_PACKAGE_PYTHON
	help
	  CherryPy is a Minimalist Python Web Framework

	  http://www.cherrypy.org/
```

## package/python-mako/Config.in
```kconfig
config BR2_PACKAGE_PYTHON_MAKO
	bool "python-mako"
	select BR2_PACKAGE_PYTHON_SETUPTOOLS
	select BR2_PACKAGE_PYTHON_ZLIB
	select BR2_PACKAGE_PYTHON_MARKUPSAFE
	help
	  Download, build, install, upgrade, and uninstall Python packages.

	  http://www.makotemplates.org/downloads
```

## package/python-markupsafe/Config.in
```kconfig
config BR2_PACKAGE_PYTHON_MARKUPSAFE
	bool "python-markupsafe"
	select BR2_PACKAGE_PYTHON_SETUPTOOLS
	select BR2_PACKAGE_PYTHON_ZLIB
	select BR2_PACKAGE_PYTHON_MARKUP_SAFE
	help
	  Download, build, install, upgrade, and uninstall Python packages.

	  http://www.pocoo.org/projects/markupsafe/
```

## package/python-pyopendaf/Config.in
```kconfig
config BR2_PACKAGE_PYTHON_PYOPENDAF
	bool "python-pyopendaf"
	depends on BR2_PACKAGE_PYTHON
	select BR2_PACKAGE_PYTHON_ZOPE_INTERFACE
	help
	  python-pyopendaf is an OpenDAF python wrapper.
 
```

## package/python-zope.interface/Config.in
```kconfig
config BR2_PACKAGE_PYTHON_ZOPE_INTERFACE
	bool "python-zope.interface"
	depends on BR2_PACKAGE_PYTHON
	help
	  python-zope.interface is a part of Zope3 framework
 
	  http://www.zope.org
```

## package/rc232-responder/Config.in
```kconfig
config BR2_PACKAGE_RC232_RESPONDER
	bool "rc232-responder"
	depends on BR2_PACKAGE_PYTHON && BR2_PACKAGE_PYTHON_SERIAL
	help
	  RC232 systemtest responder

comment "rc232-responder depends on python & python-serial"
	depends on !(BR2_PACKAGE_PYTHON && BR2_PACKAGE_PYTHON_SERIAL)
```

## package/remserial/Config.in
```kconfig
config BR2_PACKAGE_REMSERIAL
	bool "remserial"
	help
		This package contains remote serial port access
```

## package/rqwb/Config.in
```kconfig
config BR2_PACKAGE_RQWB
	bool "rqwb"
	help
		Restricted Qt Web Browser

	depends on BR2_PACKAGE_QT_GUI_MODULE && BR2_PACKAGE_QT_WEBKIT && BR2_PACKAGE_QT_SCRIPT

	comment "rqwb depends on Qt gui, script and webkit"
		depends on !(BR2_PACKAGE_QT_GUI_MODULE && BR2_PACKAGE_QT_WEBKIT && BR2_PACKAGE_QT_SCRIPT)
```

## package/rtuadmin-client/Config.in
```kconfig
config BR2_PACKAGE_RTUADMIN_CLIENT
	bool "rtuadmin-client"
	help
		This package contains RTUAdmin client.

comment "rtuadmin-client"
```

## package/rtuadmin/Config.in
```kconfig
menu "RTUAdmin"
source "package/rtuadmin/rtuadmin-server/Config.in"
source "package/rtuadmin/rtuadmin-client/Config.in"
source "package/rtuadmin/rtuadmin-templates/Config.in"
source "package/rtuadmin/rtuadmin-rang/Config.in"
endmenu
```
