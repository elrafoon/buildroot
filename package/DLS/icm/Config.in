## package/DLS/icm/Config.in
```kconfig
config BR2_PACKAGE_ICM
	bool "icm"
	help
		This package contains Integrated-Communication-Module.

	depends on BR2_PACKAGE_ACE

	comment "icm depends on ACE"
		depends on !BR2_PACKAGE_ACE
```

## package/HA2/ha2_opensmc/Config.in
```kconfig
config BR2_PACKAGE_HA2_OPENSMC
	bool "ha2_opensmc"
	depends on BR2_PACKAGE_ACE && BR2_PACKAGE_BOOST_SYSTEM && BR2_PACKAGE_BOOST_SIGNALS
	help
		This package contains Open Slot Machine Controller

if BR2_PACKAGE_HA2_OPENSMC

config BR2_PACKAGE_HA2_OPENSMC_DEVEL
        bool "Install development configuration"
        default n
        depends on BR2_PACKAGE_HA2_OPENSMC

choice
	prompt "Start-up method"
	default BR2_PACKAGE_HA2_OPENSMC_STARTUP_INITSCRIPT
	depends on BR2_PACKAGE_HA2_OPENSMC

config BR2_PACKAGE_HA2_OPENSMC_STARTUP_NONE
	bool "none"

config BR2_PACKAGE_HA2_OPENSMC_STARTUP_INITSCRIPT
	bool "initscript"

config BR2_PACKAGE_HA2_OPENSMC_STARTUP_RUNIT
	bool "RUnit (requires RUnit support in busybox)"

endchoice
endif


comment "OpenSMC depends on ACE, boost-system and boost-signals"
	depends on !(BR2_PACKAGE_ACE && BR2_PACKAGE_BOOST_SYSTEM && BR2_PACKAGE_BOOST_SIGNALS)
```

## package/ILOS/ihal/Config.in
```kconfig
config BR2_PACKAGE_IHAL
	bool "ihal"
	help
		This package contains ihal.

		http://www.tind.sk/ilos

	select BR2_PACKAGE_ACE
        depends on BR2_PACKAGE_PCRE

comment "ihal depends on pcre"
    depends on !BR2_PACKAGE_PCRE

if BR2_PACKAGE_IHAL

config BR2_PACKAGE_IHAL_BUILD_TESTS
    bool "build tests"
    select BR2_PACKAGE_GMOCK
endif # BR2_PACKAGE_IHAL
```

## package/OPENBOX/Config.in
```kconfig
menu "OPENBOX"
source "package/OPENBOX/openbox_webadmin/Config.in"
source "package/OPENBOX/openbox_templates/Config.in"
endmenu
```

## package/OPENBOX/openbox_templates/Config.in
```kconfig
config BR2_PACKAGE_OPENBOX_TEMPLATES
	bool "openbox_templates"
	help
	  OpenBox system templates
```

## package/OPENBOX/openbox_webadmin/Config.in
```kconfig
config BR2_PACKAGE_OPENBOX_WEBADMIN
	bool "openbox_webadmin"
	select BR2_PACKAGE_PYTHON_SETUPTOOLS
	select BR2_PACKAGE_PYTHON_SQLITE
	depends on BR2_PACKAGE_PYTHON && BR2_PACKAGE_PYTHON_CHERRYPY && BR2_PACKAGE_PYTHON_MAKO && BR2_PACKAGE_UTIL_LINUX && BR2_PACKAGE_UTIL_LINUX_CHFN_CHSH
	help
	  OpenBox web admin

if BR2_PACKAGE_OPENBOX_WEBADMIN

choice
        prompt "Start-up method"
        default BR2_PACKAGE_OPENBOX_WEBADMIN_STARTUP_INITSCRIPT
        depends on BR2_PACKAGE_OPENBOX_WEBADMIN

config BR2_PACKAGE_OPENBOX_WEBADMIN_STARTUP_NONE
        bool "none"

config BR2_PACKAGE_OPENBOX_WEBADMIN_STARTUP_INITSCRIPT
        bool "initscript"

config BR2_PACKAGE_OPENBOX_WEBADMIN_STARTUP_RUNIT
        bool "RUnit (requires RUnit support in busybox)"

endchoice

endif

comment "openbox_webadmin depends on python, python-cherrypy, python-mako and util-linux with chfn"
	depends on !BR2_PACKAGE_PYTHON || !BR2_PACKAGE_PYTHON_CHERRYPY || !BR2_PACKAGE_PYTHON_MAKO || !BR2_PACKAGE_UTIL_LINUX || !BR2_PACKAGE_UTIL_LINUX_CHFN_CHSH
```

## package/SUZI/Config.in
```kconfig
menu "SUZI"
source "package/SUZI/scl/Config.in"
source "package/SUZI/suquation/Config.in"
source "package/SUZI/suhmicpp/Config.in"
source "package/SUZI/surpc/Config.in"
endmenu
```

## package/SUZI/scl/Config.in
```kconfig
config BR2_PACKAGE_SCL
	bool "scl"
	help
		This package contains Suhub-Connector-Light.

		http://www.tind.sk/suzi

	depends on (BR2_PACKAGE_ACE && BR2_PACKAGE_BOOST && BR2_PACKAGE_BOOST_SYSTEM)

	comment "scl depends on ACE, Boost and Boost_System"
		depends on !(BR2_PACKAGE_ACE && BR2_PACKAGE_BOOST && BR2_PACKAGE_BOOST_SYSTEM)
```

## package/SUZI/suhmicpp/Config.in
```kconfig
config BR2_PACKAGE_SUHMICPP
	bool "suhmi-cpp"
	help
		This package contains SuHmiCpp runtime.

		http://www.tind.sk/suzi

	depends on (BR2_PACKAGE_QT && BR2_PACKAGE_ACE && BR2_PACKAGE_SCL && BR2_PACKAGE_PYTHON && BR2_PACKAGE_LIBTAR && BR2_PACKAGE_SIMPLEDB && BR2_PACKAGE_LIBCONFIG && BR2_PACKAGE_QT_SVG && BR2_PACKAGE_QT_XML && BR2_PACKAGE_QT_XMLPATTERNS && BR2_PACKAGE_QT_STL)

	comment "suhmi-cpp depends on: QT(with SVG,XML,XMLPATTERNS,STL), ACE, SCL, PYTHON, LIBTAR, SIMPLEDB, LIBCONFIG"
		depends on !(BR2_PACKAGE_QT && BR2_PACKAGE_ACE && BR2_PACKAGE_SCL && BR2_PACKAGE_PYTHON && BR2_PACKAGE_LIBTAR && BR2_PACKAGE_SIMPLEDB && BR2_PACKAGE_LIBCONFIG && BR2_PACKAGE_QT_SVG && BR2_PACKAGE_QT_XML && BR2_PACKAGE_QT_XMLPATTERNS && BR2_PACKAGE_QT_STL)
		
```

## package/SUZI/suquation/Config.in
```kconfig
config BR2_PACKAGE_SUQUATION
	bool "suquation"
	help
		This package contains SuQuation runtime.

		http://www.tind.sk/suzi

	depends on (BR2_PACKAGE_ACE && BR2_PACKAGE_BOOST && BR2_PACKAGE_BOOST_SYSTEM && BR2_PACKAGE_BOOST_REGEX && BR2_PACKAGE_BOOST_FILESYSTEM && BR2_PACKAGE_BOOST_PROGRAM_OPTIONS && BR2_PACKAGE_XERCES && BR2_PACKAGE_SCL)

	comment "suquation depends on: ACE, BOOST(System,Regex,Filesystem,Program_Options), XERCES, SCL"
		depends on !(BR2_PACKAGE_ACE && BR2_PACKAGE_BOOST && BR2_PACKAGE_BOOST_SYSTEM && BR2_PACKAGE_BOOST_REGEX && BR2_PACKAGE_BOOST_FILESYSTEM && BR2_PACKAGE_BOOST_PROGRAM_OPTIONS && BR2_PACKAGE_XERCES && BR2_PACKAGE_SCL)
```

## package/SUZI/surpc/Config.in
```kconfig
config BR2_PACKAGE_SURPC
	bool "SuRPC"
	help
		This package contains SuRPC communication library

		http://www.tind.sk/suzi

	depends on (BR2_PACKAGE_ACE && BR2_PACKAGE_PROTOBUF)

	comment "SuRPC depends on ACE, protobuf"
		depends on !(BR2_PACKAGE_ACE && BR2_PACKAGE_PROTOBUF)


if BR2_PACKAGE_SURPC

config BR2_PACKAGE_SURPC_PYTHON
	bool "Build python module"
	depends on (BR2_PACKAGE_PYTHON && BR2_PACKAGE_PYTHON_PROTOBUF)
	default n
	comment "SuRPC python module depends on python and python-protobuf"
		depends on !(BR2_PACKAGE_PYTHON && BR2_PACKAGE_PYTHON_PROTOBUF)


endif
```

## package/adroctech/Config.in
```kconfig
menu "ADROCTECH"
source "package/adroctech/jt/Config.in"
source "package/adroctech/monitor/Config.in"
endmenu
```

## package/adroctech/jt/Config.in
```kconfig
config BR2_PACKAGE_JT
	bool "jt"
	help
		This package contains jpeg test

	depends on BR2_PACKAGE_JPEG

	comment "jpeg-test depends on jpeg"
		depends on !BR2_PACKAGE_JPEG
```

## package/adroctech/monitor/Config.in
```kconfig
config BR2_PACKAGE_MONITOR
	bool "monitor"
	help
		This package contains monitor

	depends on (BR2_PACKAGE_ACE && BR2_PACKAGE_QT && BR2_PACKAGE_PCRE && BR2_PACKAGE_JPEG && BR2_PACKAGE_OPENCV_LIB_CORE && BR2_PACKAGE_OPENCV_LIB_IMGPROC && BR2_PACKAGE_OPENCV_LIB_HIGHGUI)

	comment "monitor depends on ACE and QT and pcre and jpeg and opencv-core and opencv-imgproc and opencv-highgui"
		depends on !(BR2_PACKAGE_ACE && BR2_PACKAGE_QT && BR2_PACKAGE_PCRE && BR2_PACKAGE_JPEG && BR2_PACKAGE_OPENCV_LIB_CORE && BR2_PACKAGE_OPENCV_LIB_IMGPROC && BR2_PACKAGE_OPENCV_LIB_HIGHGUI)
```

## package/astroclock/Config.in
```kconfig
config BR2_PACKAGE_ASTROCLOCK
	bool "astroclock"
	depends on BR2_PACKAGE_DCRON
	help
	  Astronomical clock calculation package

if BR2_PACKAGE_ASTROCLOCK
	config BR2_PACKAGE_ASTROCLOCK_CGI
		bool "install CGI wrapper"
		default y

endif

comment "astroclock depends on dcron"
	depends on !BR2_PACKAGE_DCRON
```

## package/bluecore/Config.in
```kconfig
config BR2_PACKAGE_BLUECORE
	bool "BlueCore"
	default n
	depends on BR2_PACKAGE_BLUEZ_UTILS_BCCMD
	help
	  Bootstrap & attach BlueCore-compatible bluetooth device

comment "BlueCore depends on bluez-utils bccmd"
	depends on !BR2_PACKAGE_BLUEZ_UTILS_BCCMD

if BR2_PACKAGE_BLUECORE

config BR2_PACKAGE_BLUECORE_KEYFILE
	string "BlueCore keyfile to use?"
	default "package/bluecore/wt21-460800.psr"
	help
	  Keyfile used to bootstrap the BlueCore device.

config BR2_PACKAGE_BLUECORE_RESET_GPIO
	string "Reset signal GPIO number"
	help
	  GPIO reset signal port number, leave empty to not use reset.

config BR2_PACKAGE_BLUECORE_RESET_ACT
	int "Reset signal active state"
	default 0
	help
	  BlueCore reset active state, 0=low, 1=high.

config BR2_PACKAGE_BLUECORE_RESET_HOLD_TIME
	int "Reset signal hold time [us]"
	default 100000
	help
	  Reset signal hold time in microseconds

config BR2_PACKAGE_BLUECORE_TTY
	string "Attached to serial device"
	help
	  Serial (TTY) device, to which bluecore device is attached

config BR2_PACKAGE_BLUECORE_BAUDRATE
	int "Serial link baudrate (must match keyfile)"
	default 460800
	help
	  Baudrate of serial communication link, must match value configured in keyfile

choice
	prompt "Flow contol"
	default BR2_PACKAGE_BLUECORE_FLOW_NONE
	help
	  Select flow control method

	config BR2_PACKAGE_BLUECORE_FLOW_NONE
		bool "no flow control"

	config BR2_PACKAGE_BLUECORE_FLOW_RTSCTS
		bool "RTS/CTS flow control"

endchoice

endif
```

## package/crontab-cgi/Config.in
```kconfig
config BR2_PACKAGE_CRONTAB_CGI
	bool "crontab-cgi"
	help
	  Simple crontab management CGI script written in dash
```

## package/downtime/Config.in
```kconfig
config BR2_PACKAGE_DOWNTIME
	bool "downtime"
	depends on BR2_PACKAGE_DCRON
	help
	  Downtime reporting tool

if BR2_PACKAGE_DOWNTIME
	config BR2_PACKAGE_DOWNTIME_CGI
		bool "install CGI wrapper"
		default y

endif

comment "downtime depends on dcron"
	depends on !BR2_PACKAGE_DCRON
```

## package/errord/Config.in
```kconfig
config BR2_PACKAGE_ERRORD
	bool "errord"
	help
	  Turn on error led when conditions are met
```

## package/fwupdate/Config.in
```kconfig
config BR2_PACKAGE_FWUPDATE
	bool "fwupdate"
	depends on BR2_PACKAGE_E2FSPROGS && BR2_PACKAGE_E2FSPROGS_RESIZE2FS && BR2_PACKAGE_FILE && BR2_PACKAGE_GNUPG && BR2_PACKAGE_GNUPG_RSA && BR2_PACKAGE_UTIL_LINUX_BINARIES && BR2_PACKAGE_MTD_NANDWRITE
	help
	  Safe firmware update / recovery tool

if BR2_PACKAGE_FWUPDATE
	config BR2_PACKAGE_FWUPDATE_INSTALL_MARKREADY_INITSCRIPT
		bool "Install mark-ready initscript"
		help
		  Whether to install an initscript that would mark the target
		  filesystem as ready when boot completes.

endif

comment "fwupdate depends on e2fsprogs with resize2fss, file, gnupg with rsa, util-linux with binaries installed and mtd with nandwrite"
	depends on !(BR2_PACKAGE_E2FSPROGS && BR2_PACKAGE_E2FSPROGS_RESIZE2FS && BR2_PACKAGE_FILE && BR2_PACKAGE_GNUPG && BR2_PACKAGE_GNUPG_RSA && BR2_PACKAGE_UTIL_LINUX_BINARIES && BR2_PACKAGE_MTD_NANDWRITE)
```

## package/gmock/Config.in
```kconfig
config BR2_PACKAGE_GMOCK
	bool "gmock"
	help
	  google-mock.
          http://code.google.com/p/googlemock
```

## package/iptables-firewall/Config.in
```kconfig
config BR2_PACKAGE_IPTABLES_FIREWALL
	bool "iptables-firewall"
	depends on BR2_PACKAGE_SYSTEMD && BR2_PACKAGE_IPTABLES
	help
	  Setup iptables firewall rules on bootup

comment "iptables-firewall requires systemd and iptables"
	depends on !(BR2_PACKAGE_SYSTEMD && BR2_PACKAGE_IPTABLES)
```

## package/json-dbus-bridge/Config.in
```kconfig
config BR2_PACKAGE_JSON_DBUS_BRIDGE
	bool "json-dbus-bridge"
	depends on BR2_PACKAGE_DBUS
	depends on BR2_PACKAGE_LIBFCGI
	select BR2_PACKAGE_JSON_C
	select BR2_PACKAGE_LIBEVENT
	help
	  The JSON-D-Bus-bridge is a fastcgi application that provides access to D-Bus.
	  It accepts JSON-RPC calls as used for instance by qooxdoo and translates these into D-Bus calls. Any response is converted back to JSON and sent to the client.
	  The bridge is completely generic. New D-Bus services can be added without modifications to the bridge. 

	  http://www.pengutronix.de/software/json-dbus-bridge/index_en.html
	  https://gitorious.org/json-dbus-bridge

comment "json-dbus-bridge depends on dbus, libfcgi and libevent"
	depends on !(BR2_PACKAGE_DBUS && BR2_PACKAGE_LIBFCGI && BR2_PACKAGE_LIBEVENT)
```
